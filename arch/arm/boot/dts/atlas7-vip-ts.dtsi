/*
 * DTS file for CSR SiRFatlas7 SoC VIP TS port
 *
 * Copyright (c) 2016, The Linux Foundation. All rights reserved.
 *
 * This program is free software; you can redistribute it and/or modify
 * it under the terms of the GNU General Public License version 2 and
 * only version 2 as published by the Free Software Foundation.
 *
 * This program is distributed in the hope that it will be useful,
 * but WITHOUT ANY WARRANTY; without even the implied warranty of
 * MERCHANTABILITY or FITNESS FOR A PARTICULAR PURPOSE.  See the
 * GNU General Public License for more details.
 */

/ {
	noc {
		vdifm {
			vip1@13160000 {
				compatible = "sirf,atlas7-vip_ts";
				status = "okay";
				pinctrl-names = "default";
				pinctrl-0 = <&vi_vip1_low8bit_pmx>;
			};
		};
	};
};
