/*
 * DTS file for CSR SiRFatlas7 Evaluation Board installed with QCA6574 &
 * CSR8311.
 *
 * Copyright (c) 2014-2016 The Linux Foundation. All rights reserved.
 *
 * This program is free software; you can redistribute it and/or modify
 * it under the terms of the GNU General Public License version 2 and
 * only version 2 as published by the Free Software Foundation.
 *
 * This program is distributed in the hope that it will be useful,
 * but WITHOUT ANY WARRANTY; without even the implied warranty of
 * MERCHANTABILITY or FITNESS FOR A PARTICULAR PURPOSE.  See the
 * GNU General Public License for more details.
 */

/dts-v1/;

/include/ "atlas7.dtsi"
#include "atlas7-evb-common.dtsi"
#include "atlas7-dual-common.dtsi"
#include "atlas7-rome.dtsi"
/*
 * the usp port can be used as SPI port or the TS port,
 * so we can select the different function by include
 * the specified dtsi file.
 * atlas7-usp-spi.dtsi : the SPI port setting.
 * atlas7-usp-ts.dtsi :  the TS port setting.

 #include "atlas7-usp-ts.dtsi"
*/

/*
 * the vip port can be used as ts port or the ccir656/ccir601 port,
 * we can select the different function by include
 * the specified dtsi file.
 * atlas7-vip-ts.dtsi : the ts port setting.
 * atlas7-vip-ccir.dtsi :  the ccir port setting.
*/
#include "atlas7-vip-ccir.dtsi"
