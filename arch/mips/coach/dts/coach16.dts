/dts-v1/;

/include/ "coach16.dtsi"

/ {
	compatible = "csr,coach16-soc";
	model = "CSR COACH16 soc";

	memory {
		device_type = "memory";
		reg = <0x100000 0x4000000>;
	};

	chosen {
		bootargs = "console=ttyS0,115200n8";
	};
};
