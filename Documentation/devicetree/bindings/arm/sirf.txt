## arch/arm/configs/prima2cb_defconfig
```kconfig
CONFIG_SYSVIPC=y
CONFIG_NO_HZ=y
CONFIG_HIGH_RES_TIMERS=y
CONFIG_RELAY=y
CONFIG_BLK_DEV_INITRD=y
CONFIG_INITRAMFS_SOURCE="${IFSLIST}"
CONFIG_INITRAMFS_COMPRESSION_GZIP=y
CONFIG_KALLSYMS_ALL=y
CONFIG_PERF_EVENTS=y
CONFIG_MODULES=y
CONFIG_MODULE_UNLOAD=y
# CONFIG_BLK_DEV_BSG is not set
CONFIG_PARTITION_ADVANCED=y
CONFIG_BSD_DISKLABEL=y
CONFIG_SOLARIS_X86_PARTITION=y
CONFIG_ARCH_SIRF=y
# CONFIG_SWP_EMULATE is not set
CONFIG_SMP=y
CONFIG_NR_CPUS=2
CONFIG_PREEMPT=y
CONFIG_AEABI=y
CONFIG_ZBOOT_ROM_TEXT=0x0
CONFIG_ZBOOT_ROM_BSS=0x0
CONFIG_KEXEC=y
CONFIG_CPU_IDLE=y
CONFIG_VFP=y
CONFIG_BINFMT_AOUT=y
CONFIG_BINFMT_MISC=y
CONFIG_PM_RUNTIME=y
CONFIG_PM_DEBUG=y
CONFIG_PM_ADVANCED_DEBUG=y
CONFIG_PACKET=y
CONFIG_PACKET_DIAG=y
CONFIG_UNIX=y
CONFIG_UNIX_DIAG=y
CONFIG_UEVENT_HELPER_PATH="/sbin/hotplug"
CONFIG_BLK_DEV_LOOP=y
CONFIG_SCSI=y
CONFIG_BLK_DEV_SD=y
CONFIG_CHR_DEV_SG=y
# CONFIG_NET_VENDOR_BROADCOM is not set
# CONFIG_NET_VENDOR_CIRRUS is not set
# CONFIG_NET_VENDOR_FARADAY is not set
# CONFIG_NET_VENDOR_INTEL is not set
# CONFIG_NET_VENDOR_MARVELL is not set
# CONFIG_NET_VENDOR_MICREL is not set
# CONFIG_NET_VENDOR_MICROCHIP is not set
# CONFIG_NET_VENDOR_NATSEMI is not set
# CONFIG_NET_VENDOR_SEEQ is not set
# CONFIG_NET_VENDOR_SMSC is not set
# CONFIG_NET_VENDOR_STMICRO is not set
# CONFIG_NET_VENDOR_WIZNET is not set
# CONFIG_WLAN is not set
CONFIG_INPUT_EVDEV=y
# CONFIG_INPUT_MOUSE is not set
CONFIG_INPUT_TOUCHSCREEN=y
CONFIG_TOUCHSCREEN_SIRFSOC=y
CONFIG_SERIAL_SIRFSOC=y
CONFIG_SERIAL_SIRFSOC_CONSOLE=y
CONFIG_HW_RANDOM=y
CONFIG_I2C=y
CONFIG_I2C_CHARDEV=y
CONFIG_I2C_SIRF=y
CONFIG_SPI=y
CONFIG_SPI_SIRF=y
CONFIG_SPI_SPIDEV=y
CONFIG_DEBUG_GPIO=y
CONFIG_GPIO_SYSFS=y
CONFIG_GPIO_GENERIC_PLATFORM=y
CONFIG_POWER_SUPPLY=y
# CONFIG_HWMON is not set
CONFIG_THERMAL=y
CONFIG_MEDIA_SUPPORT=y
CONFIG_MEDIA_CAMERA_SUPPORT=y
CONFIG_V4L_PLATFORM_DRIVERS=y
CONFIG_SOC_CAMERA=y
CONFIG_VIDEO_SIRFSOC_VIP=y
# CONFIG_MEDIA_SUBDRV_AUTOSELECT is not set
CONFIG_SOC_CAMERA_TW9900=y
CONFIG_FB=y
CONFIG_FB_SIRF=y
CONFIG_LOGO=y
# CONFIG_LOGO_LINUX_MONO is not set
# CONFIG_LOGO_LINUX_VGA16 is not set
# CONFIG_LOGO_LINUX_CLUT224 is not set
CONFIG_SOUND=y
CONFIG_SND=y
CONFIG_SND_SOC=y
CONFIG_SND_SIRF_SOC=y
CONFIG_SND_SIRF_INNER=y
# CONFIG_USB_SUPPORT is not set
CONFIG_MMC=y
CONFIG_MMC_SDHCI=y
CONFIG_MMC_SDHCI_PLTFM=y
CONFIG_MMC_SDHCI_SIRF=y
CONFIG_DMADEVICES=y
CONFIG_DMADEVICES_DEBUG=y
CONFIG_DMADEVICES_VDEBUG=y
CONFIG_SIRF_DMA=y
CONFIG_ASYNC_TX_DMA=y
# CONFIG_IOMMU_SUPPORT is not set
CONFIG_EXT4_FS=y
CONFIG_MSDOS_FS=y
CONFIG_VFAT_FS=y
CONFIG_TMPFS=y
CONFIG_TMPFS_POSIX_ACL=y
CONFIG_CRAMFS=y
CONFIG_ROMFS_FS=y
CONFIG_NLS_CODEPAGE_437=y
CONFIG_NLS_ASCII=y
CONFIG_NLS_ISO8859_1=y
CONFIG_PRINTK_TIME=y
CONFIG_MAGIC_SYSRQ=y
CONFIG_DEBUG_SECTION_MISMATCH=y
CONFIG_DEBUG_KERNEL=y
# CONFIG_DEBUG_PREEMPT is not set
CONFIG_DEBUG_RT_MUTEXES=y
CONFIG_DEBUG_SPINLOCK=y
CONFIG_DEBUG_MUTEXES=y
CONFIG_DEBUG_INFO=y
CONFIG_DEBUG_LL=y
CONFIG_EARLY_PRINTK=y
CONFIG_CRC_CCITT=y
```

## arch/arm/configs/vexpressfront_defconfig
```kconfig
# CONFIG_LOCALVERSION_AUTO is not set
# CONFIG_SWAP is not set
CONFIG_SYSVIPC=y
CONFIG_NO_HZ_IDLE=y
CONFIG_VIRT_CPU_ACCOUNTING_GEN=y
# CONFIG_CONTEXT_TRACKING_FORCE is not set
CONFIG_IKCONFIG=y
CONFIG_IKCONFIG_PROC=y
CONFIG_LOG_BUF_SHIFT=14
CONFIG_CGROUPS=y
CONFIG_CPUSETS=y
# CONFIG_UTS_NS is not set
# CONFIG_IPC_NS is not set
# CONFIG_PID_NS is not set
CONFIG_BLK_DEV_INITRD=y
CONFIG_INITRAMFS_SOURCE="arch/arm/mach-vexpress/initramfs_data.cpio.gz"
CONFIG_INITRAMFS_COMPRESSION_GZIP=y
# CONFIG_LBDAF is not set
# CONFIG_BLK_DEV_BSG is not set
# CONFIG_IOSCHED_DEADLINE is not set
# CONFIG_IOSCHED_CFQ is not set
CONFIG_ARCH_VEXPRESS=y
CONFIG_ARCH_VEXPRESS_CA9X4=y
# CONFIG_SWP_EMULATE is not set
# CONFIG_CACHE_L2X0 is not set
CONFIG_SMP=y
# CONFIG_SMP_ON_UP is not set
# CONFIG_ARM_CPU_TOPOLOGY is not set
CONFIG_AEABI=y
CONFIG_OABI_COMPAT=y
CONFIG_ZBOOT_ROM_TEXT=0x0
CONFIG_ZBOOT_ROM_BSS=0x0
CONFIG_CMDLINE="root=/dev/nfs nfsroot=10.1.69.3:/work/nfsroot ip=dhcp console=ttyAMA0 mem=128M"
# CONFIG_CORE_DUMP_DEFAULT_ELF_HEADERS is not set
# CONFIG_SUSPEND is not set
CONFIG_UEVENT_HELPER_PATH="/sbin/hotplug"
# CONFIG_BLK_DEV is not set
# CONFIG_INPUT_MOUSEDEV_PSAUX is not set
# CONFIG_INPUT_KEYBOARD is not set
# CONFIG_INPUT_MOUSE is not set
# CONFIG_SERIO is not set
CONFIG_VT_HW_CONSOLE_BINDING=y
CONFIG_LEGACY_PTY_COUNT=16
CONFIG_SERIAL_AMBA_PL011=y
CONFIG_SERIAL_AMBA_PL011_CONSOLE=y
# CONFIG_HW_RANDOM is not set
# CONFIG_HWMON is not set
# CONFIG_HID is not set
# CONFIG_USB_SUPPORT is not set
# CONFIG_IOMMU_SUPPORT is not set
CONFIG_EXT4_FS=y
CONFIG_VFAT_FS=y
CONFIG_TMPFS=y
# CONFIG_MISC_FILESYSTEMS is not set
CONFIG_NLS_CODEPAGE_437=y
CONFIG_NLS_ISO8859_1=y
CONFIG_DEBUG_INFO=y
CONFIG_DEBUG_FS=y
CONFIG_MAGIC_SYSRQ=y
CONFIG_DEBUG_KERNEL=y
CONFIG_DETECT_HUNG_TASK=y
# CONFIG_SCHED_DEBUG is not set
# CONFIG_FTRACE is not set
CONFIG_DEBUG_USER=y
CONFIG_DEBUG_LL=y
CONFIG_DEBUG_VEXPRESS_UART0_CA9=y
CONFIG_EARLY_PRINTK=y
# CONFIG_CRYPTO_ANSI_CPRNG is not set
# CONFIG_CRYPTO_HW is not set
```

## drivers/misc/usp_ts/Kconfig
```kconfig
config ATLAS7_USP_TS
	tristate "atlas7 usp ts module"
	depends on ARCH_ATLAS7
	default y
	select REGMAP_MMIO
	---help---
	  Support for atlas7 usp ts module.

config ATLAS7_USP_TS_DEBUG
	bool "atlas7 usp ts module debug"
	depends on ATLAS7_USP_TS
	default n
	---help---
	  output the message in the isr.
```

## drivers/remoteproc/Kconfig
```kconfig
menu "Remoteproc drivers"

# REMOTEPROC gets selected by whoever wants it
config REMOTEPROC
	tristate
	depends on HAS_DMA
	select CRC32
	select FW_LOADER
	select VIRTIO
	select VHOST_RING
	select VIRTUALIZATION

config OMAP_REMOTEPROC
	tristate "OMAP remoteproc support"
	depends on HAS_DMA
	depends on ARCH_OMAP4 || SOC_OMAP5
	depends on OMAP_IOMMU
	select REMOTEPROC
	select MAILBOX
	select OMAP2PLUS_MBOX
	select RPMSG
	help
	  Say y here to support OMAP's remote processors (dual M3
	  and DSP on OMAP4) via the remote processor framework.

	  Currently only supported on OMAP4.

	  Usually you want to say y here, in order to enable multimedia
	  use-cases to run on your platform (multimedia codecs are
	  offloaded to remote DSP processors using this framework).

	  It's safe to say n here if you're not interested in multimedia
	  offloading or just want a bare minimum kernel.

config STE_MODEM_RPROC
	tristate "STE-Modem remoteproc support"
	depends on HAS_DMA
	select REMOTEPROC
	default n
	help
	  Say y or m here to support STE-Modem shared memory driver.
	  This can be either built-in or a loadable module.
	  If unsure say N.

config DA8XX_REMOTEPROC
	tristate "DA8xx/OMAP-L13x remoteproc support"
	depends on ARCH_DAVINCI_DA8XX
	select CMA if MMU
	select REMOTEPROC
	select RPMSG
	help
	  Say y here to support DA8xx/OMAP-L13x remote processors via the
	  remote processor framework.

	  You want to say y here in order to enable AMP
	  use-cases to run on your platform (multimedia codecs are
	  offloaded to remote DSP processors using this framework).

	  This module controls the name of the firmware file that gets
	  loaded on the DSP.  This file must reside in the /lib/firmware
	  directory.  It can be specified via the module parameter
	  da8xx_fw_name=<filename>, and if not specified will default to
	  "rproc-dsp-fw".

	  It's safe to say n here if you're not interested in multimedia
	  offloading.

# config CSR hypervisor remoteproc.
config CSRVISOR_SW_FIFO
	tristate
	default n

config CSRVISOR_REMOTEPROC
	tristate
	select REMOTEPROC
	select CSRVISOR_SW_FIFO
	default n

config CSRVISOR_REMOTEPROC_BACKEND
	tristate "CSRVisor remoteproc support for backend OS"
	depends on SECURITY_MODE
	select VIRTIO_BACKEND
	select CSRVISOR_REMOTEPROC
	default n
	help
	  Say y here to support CSR hypervisor remote processors via the
	  remote processor framework in backend OS which is running
	  in ARM secure mode.

	  This can be either built-in or a loadable module.
	  If unsure say N.

config CSRVISOR_REMOTEPROC_FRONTEND
	tristate "CSRVisor remoteproc support for frontend OS"
	depends on !SECURITY_MODE
	select CSRVISOR_REMOTEPROC
	default n
	help
	  Say y here to support CSR hypervisor remote processors via the
	  remote processor framework in frontend OS which is running
	  in ARM non-secure mode.

	  This can be either built-in or a loadable module.
	  If unsure say N.

config SIRF_REMOTEPROC
	tristate
	select REMOTEPROC
	default n

config SIRF_REMOTEPROC_BACKEND
	tristate "SIRF remoteproc support for backend OS"
	depends on SECURITY_MODE
	select VIRTIO_BACKEND
	select SIRF_REMOTEPROC
	default n
	help
	  Say y here to support SIRF remote processors via the
	  remote processor framework in backend OS which is running
	  in ARM secure mode.

	  This can be either built-in or a loadable module.
	  If unsure say N.

config SIRF_REMOTEPROC_FRONTEND
	tristate "SIRF remoteproc support for frontend OS"
	depends on !SECURITY_MODE
	select SIRF_REMOTEPROC
	default n
	help
	  Say y here to support SIRF remote processors via the
	  remote processor framework in frontend OS which is running
	  in ARM non-secure mode.

	  This can be either built-in or a loadable module.
	  If unsure say N.

endmenu
```

## drivers/rpmsg/Kconfig
```kconfig
menu "Rpmsg drivers"

# RPMSG always gets selected by whoever wants it
config RPMSG_FRONTEND
	tristate
	default n

config RPMSG_BACKEND
	tristate
	default n

config RPMSG
	tristate
	select VIRTIO
	select VIRTUALIZATION
	select RPMSG_BACKEND if (REMOTEPROC && SECURITY_MODE)
	select RPMSG_FRONTEND if (REMOTEPROC && !SECURITY_MODE)

endmenu
```

## drivers/usb/chipidea/Kconfig
```kconfig
config USB_CHIPIDEA
	tristate "ChipIdea Highspeed Dual Role Controller"
	depends on ((USB_EHCI_HCD && USB_GADGET) || (USB_EHCI_HCD && !USB_GADGET) || (!USB_EHCI_HCD && USB_GADGET)) && HAS_DMA
	help
	  Say Y here if your system has a dual role high speed USB
	  controller based on ChipIdea silicon IP. Currently, only the
	  peripheral mode is supported.

	  When compiled dynamically, the module will be called ci-hdrc.ko.

if USB_CHIPIDEA

config USB_CHIPIDEA_UDC
	bool "ChipIdea device controller"
	depends on USB_GADGET
	help
	  Say Y here to enable device controller functionality of the
	  ChipIdea driver.

config USB_CHIPIDEA_HOST
	bool "ChipIdea host controller"
	depends on USB_EHCI_HCD
	select USB_EHCI_ROOT_HUB_TT
	help
	  Say Y here to enable host controller functionality of the
	  ChipIdea driver.

config USB_CHIPIDEA_DEBUG
	bool "ChipIdea driver debug"
	help
	  Say Y here to enable debugging output of the ChipIdea driver.

if USB_CHIPIDEA_UDC && USB_CHIPIDEA_HOST

config USB_CHIPIDEA_SIRF
	depends on ARCH_SIRF
	bool "SiRF USB controller ChipIdea driver binding"
	help
	  Say Y here to enable sirf usb ChipIdea driver binding.

config USB_CHIPIDEA_MSM
	depends on ARCH_MSM
	bool "MSM USB controller ChipIdea driver binding"
	help
	  Say Y here to enable msm usb ChipIdea driver binding.

config USB_CHIPIDEA_IMX
	depends on ARCH_MXC || ARCH_MXS
	bool "i.MX USB controller ChipIdea driver binding"
	help
	  Say Y here to enable imx usb ChipIdea driver binding.

endif

endif
```

## sound/soc/sirf/kalimba-m3/Kconfig
```kconfig
config SND_SOC_SIRF_KALIMBA_M3
	tristate "Kalimba m3 driver"
	help
	  Kalimba is audio DSP process which support mix, sample rate
	  convert and echo cancellation etc features. Kalimba gets the
	  audio data from the frontend device and puts the audio data
	  to backend device.

config SND_SOC_SIRF_KALIMBA_DEBUG
	tristate "Kalimba driver debug"
	depends on SND_SOC_SIRF_KALIMBA || SND_SOC_SIRF_KALIMBA_M3
	help
	  Kalimba debug interface which helps to develop the code of kalimba,
	  it alloc, free and fill memory by test tool use.
	  It also initialize hardware audio device, such as I2S, codec and dma.
	  It also prepare the interface to user space test tools.
```
