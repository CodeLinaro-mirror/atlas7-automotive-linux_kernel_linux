## Documentation/devicetree/bindings/arm/sirf.txt
```
CSR SiRFprimaII and SiRFmarco device tree bindings.
========================================

Required root node properties:
    - compatible:
    - "sirf,atlas7-cb" : atlas7 device based board
    - "sirf,prima2-cb" : prima2 "cb" evaluation board
    - "sirf,marco-cb" : marco "cb" evaluation board
    - "sirf,atlas7" : atlas7 device based board
    - "sirf,prima2" : prima2 device based board
    - "sirf,marco" : marco device based board
```

## Documentation/devicetree/bindings/clock/atlas7-clock.txt
```
* Clock bindings for CSR atlas7

Required properties:
- compatible: Should be "sirf,atlas7-clkc"
- reg: Address and length of the register set
- #clock-cells: Should be <1>

The clock consumer should specify the desired clock by having the clock
ID in its "clocks" phandle cell.
The ID list atlas7_clks defined in drivers/clk/sirf/clk-atlas7.c

Examples:

timer@10dc0000 {
	compatible = "sirf,atlas7-tick";
	reg = <0x10dc0000 0x1000>;
	clocks = <&clks 54>;
	interrupts = <0 0 0>,
		   <0 1 0>,
		   <0 2 0>,
		   <0 49 0>,
		   <0 50 0>,
		   <0 51 0>;
};

uart1: uart@18020000 {
	cell-index = <1>;
	compatible = "sirf,atlas7-uart";
	reg = <0x18020000 0x1000>;
	clocks = <&clks 95>;
	interrupts = <0 18 0>;
	fifosize = <32>;
};
```

## Documentation/devicetree/bindings/hwspinlock/sirf,hwspinlock.txt
```
SIRF Hardware spinlock device Binding
-----------------------------------------------

Required properties :
- compatible : shall contain only one of the following:
	"sirf,hwspinlock"

- reg : the register address of hwspinlock

- num-spinlocks : how many spinlocks this device provides

Example:
	hwspinlock {
		compatible = "sirf,hwspinlock";
		reg = <0x13240000 0x00010000>;

		num-spinlocks = <30>;
	};
```

## Documentation/devicetree/bindings/i2c/sirf-i2c.txt
```
I2C for SiRFprimaII platforms

Required properties :
- compatible : Must be "sirf,prima2-i2c"
- reg: physical base address of the controller and length of memory mapped
     region.
- interrupts: interrupt number to the cpu.

Optional properties:
- Child nodes conforming to i2c bus binding

Examples :

i2c0: i2c@b00e0000 {
    compatible = "sirf,prima2-i2c";
    reg = <0xb00e0000 0x10000>;
    interrupts = <24>;
};
```

## Documentation/devicetree/bindings/mfd/sirf,atlas7-ipc.txt
```
SIRF Atlas7 Inter-Processor Communication (IPC) Device Binding
------------------------------------------------

1) Main node
	Required properties :

	- compatible : shall contain only one of the following:
			"sirf,atlas7-ipc"

	- ranges : the ipc io address range

2) Child nodes
	The main node has serval child nodes which describes
	hardware spinlock and remoteproc devices.

	For the hwspinlock properties please refer to:
	Documentation/devicetree/bindings/hwspinlock/sirf,hwspinlock.txt

	For the remoteproc properties please refer to:
	Documentation/devicetree/bindings/remoteproc/sirf,remoteproc.txt

Example:
	ipc@13240000 {
		compatible = "sirf,atlas7-ipc";
		ranges = <0x13240000 0x13240000 0x00010000>;
		#address-cells = <1>;
		#size-cells = <1>;

		hwspinlock {
			num-spinlocks = <30>;
		}

		remoteproc {
			sirf,ipc-mem = <0x40000000 0xD0000000 0x200000>;
		}
	};
```

## Documentation/devicetree/bindings/pinctrl/pinctrl-atlas7.txt
```
CSR SiRFatlas7 pinmux controller

Required properties:
- compatible	: "sirf,atlas7-ioc"
- reg		: Address range of the pinctrl registers

- sirf,pull-pins: An array of string that describe the pins that
  have pull selector.

- sirf,pull-selectors: An array of string that describe the pull
  selector of sirf,pull-pins specified pins.

- sirf,drive-strength-pins:An array of string that describe the pins that
  have drive strength selector.

- sirf,drive-strength-selectors: An array of string that describe the
  drive strength selector of drive-strength-pins specified pins.

For example, pinctrl might have properties like the following:
	pinctrl: ioc@18880000 {
			compatible = "sirf,atlas7-ioc";
			reg = <0x18880000 0x1000>;

			a_ac97_pmx: ac97@0 {
				ac97 {
					sirf,pins = "audio_ac97_grp";
					sirf,function = "audio_ac97";
				};
			};

			...

			sd2_pmx: sd2@0 {
				sd2 {
					sirf,pins = "sd2_grp0";
					sirf,function = "sd2";
				};
			};

			...

			sirf,pull-pins = "spi1_dout", "ldd_2", "trg_acq_clk",
					"ldd_15", "i2s_dout2";

			sirf,pull-selectors = "pull_up", "pull_up", "pull_down",
					"high_hysteresis", "high_z";

			sirf,drive-strength-pins = "spi1_en", "trg_spi_cs_b",
						"ldd_3", "vip_7", "sdio3_clk";

			sirf,drive-strength-selectors = "ds_m31_1", "ds_m31_0",
						"ds_4we_2", "ds_4we_3", "ds_16st_8";
	};

Please refer to pinctrl-bindings.txt in this directory for details of the common
pinctrl bindings used by client devices.

SiRFatlas7's pinmux nodes act as a container for an abitrary number of subnodes.
Each of these subnodes represents some desired configuration for a group of pins.

Required subnode-properties:
- sirf,pins : An array of strings. Each string contains the name of a group.
- sirf,function: A string containing the name of the function to mux to the
  group.

  Valid values for group and function names can be found from looking at the
  group and function arrays in driver files:
  drivers/pinctrl/pinctrl-sirf.c

For example, pinctrl might have subnodes like the following:
	sd0_pmx: sd0@0 {
		sd0 {
			sirf,pins = "sd0_grp";
			sirf,function = "sd0";
		};
	};

	sd1_pmx0: sd1@0 {
		sd1 {
			sirf,pins = "sd1_grp0";
			sirf,function = "sd1_m0";
		};
	};

	sd1_pmx1: sd1@1 {
		sd1 {
			sirf,pins = "sd1_grp1";
			sirf,function = "sd1_m1";
		};
	};

For a specific board, if it wants to use sd1,
it can add the following to its board-specific .dts file.
sd1: sd@0x12340000 {
	pinctrl-names = "default";
	pinctrl-0 = <&sd1_pmx0>;
}

or

sd1: sd@0x12340000 {
	pinctrl-names = "default";
	pinctrl-0 = <&sd1_pmx1>;
}
```

## Documentation/devicetree/bindings/power/gps-power.txt
```
SiRFSoC gps power module

gps power control is by pwrc iobg interface, thus can be
controlled by A7 by existing regmap interface.

Required properties:
- compatible: "sirf,gps-power"

Example:

gps-power {
	compatible = "sirf,gps-power";
};
```

## Documentation/devicetree/bindings/power/pwrc.txt
```
SiRFSoC Power Controller (PWRC) module

Power Controller is used to control the whole SoC power process.
The power controller controls the process of Power-On sequence,
Power-Off sequence, different power modes switching and power
status configuration. the pwrc is access by io bridge, so the
node's parent should be io bridge.

Required properties:
- compatible: "sirf,atlas7-pwrc"
- reg: Address range of pwrc register set

Example:

pwrc@3000 {
	compatible = "sirf,atlas7-pwrc";
	reg = <0x3000 0x100>;
};

pwrc@3000 {
	compatible = "sirf,prima2-pwrc";
	reg = <0x3000 0x100>;
};

pwrc@3000 {
	compatible = "sirf,marco-pwrc";
	reg = <0x3000 0x100>;
};
```

## Documentation/devicetree/bindings/serial/sirf,atlas6-uart.txt
```
*SiRFatlasVI UART Controller
Required property:
reg: Offset and length of the register set for the device
interrupts: Uart interrupt number
fifosize: Uart hardware rx/tx fifo size
clocks: Uart clock frequency
sirf,uart-dma-rx-channel: Uart rx dma channel number
sirf,uart-dma-tx-channel: Uart tx dma channel number
cts-gpios: Usp cts gpio pin
rts-gpios: Usp rts gpio pin
sirf,usp-dma-rx-channel: Usp rx dma channel number
sirf,usp-dma-tx-channel: Usp tx dma channel number

uart example:
uart0: uart@b0050000 {
			cell-index = <0>;
			compatible = "sirf,prima2-uart";
			reg = <0xb0050000 0x1000>;
			interrupts = <17>;
			fifosize = <128>;
			clocks = <&clks 13>;
			sirf,uart-dma-rx-channel = <21>;
			sirf,uart-dma-tx-channel = <2>;
};
usp-uart example:
usp1: usp@b0090000 {
			cell-index = <1>;
			compatible = "sirf,prima2-usp";
			reg = <0xb0090000 0x10000>;
			interrupts = <21>;
			fifosize = <128>;
			clocks = <&clks 29>;
			sirf,usp-dma-rx-channel = <14>;
			sirf,usp-dma-tx-channel = <15>;
};
```

## Documentation/devicetree/bindings/sound/sirf,hdmi-audio-codec.txt
```
* SiRF atlas6 and hdmi audio codec based audio setups

Required properties:
- compatible: "sirf,sirf-hdmi"
- sirf,i2s-controller: The phandle of the SiRF I2S controller.
- sirf,hdmi-audio-codec: The phandle of the hdmi audio codec.

Example:

hdmi: hdmi {
	compatible = "hdmi-audio-codec";
};
sirf-hdmi {
	compatible = "sirf,hdmi-card";
	sirf,i2s-controller = <&i2s>;
	sirf,hdmi-audio-codec = <&hdmi>;
};
```

## Documentation/devicetree/bindings/sound/sirf,inner-audio-codec.txt
```
* SiRF atlas6 and prima2 inner audio codec based audio setups

Required properties:
- compatible: "sirf,sirf-inner"
- sirf,inner-platform: phandle for the platform node
- sirf,inner-codec: phandle for the SiRF inner codec node

Optional properties:
- hp-pa-gpios: Need to be present if the board need control external
  headphone amplifier.
- spk-pa-gpios: Need to be present if the board need control external
  speaker amplifier.
- hp-switch-gpios: Need to be present if the board capable to detect jack
  insertion, removal.

Available audio endpoints for the audio-routing table:

Board connectors:
 * Headset Stereophone
 * Ext Spk
 * Line In
 * Mic

SiRF inner codec pins:
 * HPOUTL
 * HPOUTR
 * SPKOUT
 * Ext Mic
 * Mic Bias

Example:

sound {
		compatible = "sirf,sirf-inner";
		sirf,inner-codec = <&audio>;
		sirf,inner-platform = <&audio>;
		hp-pa-gpios = <&gpio 44 0>;
		spk-pa-gpios = <&gpio 46 0>;
		hp-switch-gpios = <&gpio 45 0>;
};
```

## Documentation/devicetree/bindings/sound/sirf-usp.txt
```
* SiRF SoC USP module

Required properties:
- compatible: "sirf,prima2-usp-pcm"
- reg: Base address and size entries:
- dmas: List of DMA controller phandle and DMA request line ordered pairs.
- dma-names: Identifier string for each DMA request line in the dmas property.
  These strings correspond 1:1 with the ordered pairs in dmas.

  One of the DMA channels will be responsible for transmission (should be
  named "tx") and one for reception (should be named "rx").

- clocks: USP controller clock source
- pinctrl-names: Must contain a "default" entry.
- pinctrl-NNN: One property must exist for each entry in pinctrl-names.

Example:

usp1: usp@b0090000 {
	compatible = "sirf,prima2-usp-pcm";
	reg = <0xb0090000 0x10000>;
	clocks = <&clks 29>;
	dmas = <&dmac0 14>, <&dmac0 15>;
	dma-names = "rx", "tx";
	pinctrl-names = "default";
	pinctrl-0 = <&usp0_only_utfs_pins_a>;
};
```

## Documentation/devicetree/bindings/spi/spi_sirf.txt
```
* CSR SiRFprimaII Serial Peripheral Interface

Required properties:
- compatible : Should be "sirf,prima2-spi" or "sirf,marco-spi" or
		"sirf,prima2-usp-spi" or "sirf,marco-usp-spi"
- reg : Offset and length of the register set for the device
- interrupts : Should contain SPI interrupt
- sirf,spi-num-chipselects : Contains the number of the chipselect
- cs-gpios : Specifies the gpio pins to be used for chipselects.
if want use spidev driver, you may add sub node in spi, add compatible
property "spidev" in the subnode

Example:

spi0: spi@b00d0000 {
	compatible = "sirf,prima2-spi";
	reg = <0xb00d0000 0x10000>;
	interrupts = <15>;
	sirf,spi-num-chipselects = <2>;
	cs-gpios = <&gpio 18 0>,
		   <&gpio 19 0>;
	spidev {
		compatible = "spidev";
		reg = <0>;
		spi-max-frequency = <1000000>;
	};
};
```

## Documentation/devicetree/bindings/tty/serial/sirf-uart.txt
```
* CSR SiRFatlasVI Universal Synchronous Asynchronous Receiver/Transmitter *

Required properties:
- compatible : Should be "sirf,prima2-uart" or "sirf, prima2-usp-uart"
if harware usp be setuped uart.
- reg : Offset and length of the register set for the device
- interrupts : Should contain uart interrupt
- fifosize : Should define hardware rx/tx fifo size
- clocks : Should contain uart clock number

Example:

uart0: uart@b0050000 {
	cell-index = <0>;
	compatible = "sirf,prima2-uart";
	reg = <0xb0050000 0x1000>;
	interrupts = <17>;
	fifosize = <128>;
	clocks = <&clks 13>;
};
or usp setup as uart

usp@b0080000 {
	compatible = "sirf, prima2-usp-uart";
	pinctrl-names = "default";
	pinctrl-0 = <&usp0_pins_a>;
};
```

## Documentation/devicetree/bindings/watchdog/sirfsoc_wdt.txt
```
SiRFSoC Watchdog Timer(WDT) Controller

Required properties:
- compatible: "sirf,prima2-wdt"
- reg: Address range of WDT register set

Example:

wdt@b0020000 {
	compatible = "sirf,prima2-wdt";
	reg = <0xb0020000 0x1000>;
};
```

## arch/arm/configs/marcocb_defconfig
```kconfig
CONFIG_EXPERIMENTAL=y
CONFIG_SYSVIPC=y
CONFIG_POSIX_MQUEUE=y
CONFIG_FHANDLE=y
CONFIG_NO_HZ=y
CONFIG_HIGH_RES_TIMERS=y
CONFIG_RELAY=y
CONFIG_BLK_DEV_INITRD=y
CONFIG_INITRAMFS_SOURCE="${IFSLIST}"
CONFIG_INITRAMFS_COMPRESSION_GZIP=y
CONFIG_KALLSYMS_ALL=y
CONFIG_PERF_EVENTS=y
CONFIG_MODULES=y
CONFIG_MODULE_UNLOAD=y
# CONFIG_BLK_DEV_BSG is not set
CONFIG_PARTITION_ADVANCED=y
CONFIG_BSD_DISKLABEL=y
CONFIG_SOLARIS_X86_PARTITION=y
CONFIG_ARCH_SIRF=y
CONFIG_ARM_VIRT_EXT=y
# CONFIG_SWP_EMULATE is not set
CONFIG_SMP=y
CONFIG_SCHED_MC=y
CONFIG_SCHED_SMT=y
CONFIG_NR_CPUS=2
CONFIG_PREEMPT=y
CONFIG_AEABI=y
CONFIG_KSM=y
CONFIG_ZBOOT_ROM_TEXT=0x0
CONFIG_ZBOOT_ROM_BSS=0x0
CONFIG_KEXEC=y
CONFIG_CPU_IDLE=y
CONFIG_VFP=y
CONFIG_NEON=y
CONFIG_BINFMT_AOUT=y
CONFIG_BINFMT_MISC=y
CONFIG_PM_RUNTIME=y
CONFIG_PM_DEBUG=y
CONFIG_PM_ADVANCED_DEBUG=y
CONFIG_PACKET=y
CONFIG_UNIX=y
CONFIG_UNIX_DIAG=y
CONFIG_IP_PNP=y
CONFIG_IP_PNP_DHCP=y
# CONFIG_INET_XFRM_MODE_TRANSPORT is not set
# CONFIG_INET_XFRM_MODE_TUNNEL is not set
# CONFIG_INET_XFRM_MODE_BEET is not set
# CONFIG_INET_LRO is not set
CONFIG_IPV6=y
CONFIG_UEVENT_HELPER_PATH="/sbin/hotplug"
CONFIG_DEVTMPFS=y
CONFIG_BLK_DEV_LOOP=y
CONFIG_BLK_DEV_RAM=y
CONFIG_BLK_DEV_RAM_SIZE=8192
CONFIG_SCSI=y
CONFIG_BLK_DEV_SD=y
CONFIG_CHR_DEV_SG=y
CONFIG_INPUT_EVDEV=y
# CONFIG_INPUT_MOUSE is not set
CONFIG_INPUT_TOUCHSCREEN=y
CONFIG_TOUCHSCREEN_SIRFSOC=y
CONFIG_SERIAL_SIRFSOC=y
CONFIG_SERIAL_SIRFSOC_CONSOLE=y
CONFIG_HW_RANDOM=y
CONFIG_I2C=y
CONFIG_I2C_CHARDEV=y
CONFIG_I2C_SIRF=y
CONFIG_SPI=y
CONFIG_SPI_SIRF=y
CONFIG_SPI_SPIDEV=y
CONFIG_DEBUG_GPIO=y
CONFIG_GPIO_SYSFS=y
CONFIG_GPIO_GENERIC_PLATFORM=y
CONFIG_POWER_SUPPLY=y
# CONFIG_HWMON is not set
CONFIG_BATTERY_SIRFSOC=y
CONFIG_THERMAL=y
CONFIG_USB_GADGET=y
CONFIG_USB_FILE_STORAGE=m
CONFIG_USB_MASS_STORAGE=m
CONFIG_MMC=y
CONFIG_MMC_SDHCI=y
CONFIG_MMC_SDHCI_PLTFM=y
CONFIG_MMC_SDHCI_SIRF=y
CONFIG_DMADEVICES=y
CONFIG_DMADEVICES_DEBUG=y
CONFIG_DMADEVICES_VDEBUG=y
CONFIG_SIRF_DMA=y
# CONFIG_IOMMU_SUPPORT is not set
CONFIG_EXT4_FS=y
CONFIG_EXT4_FS_POSIX_ACL=y
CONFIG_FUSE_FS=y
CONFIG_CUSE=y
CONFIG_MSDOS_FS=y
CONFIG_VFAT_FS=y
CONFIG_TMPFS=y
CONFIG_TMPFS_POSIX_ACL=y
CONFIG_CRAMFS=y
CONFIG_ROMFS_FS=y
CONFIG_NLS_CODEPAGE_437=y
CONFIG_NLS_ASCII=y
CONFIG_NLS_ISO8859_1=y
CONFIG_MAGIC_SYSRQ=y
CONFIG_DEBUG_SECTION_MISMATCH=y
CONFIG_DEBUG_KERNEL=y
# CONFIG_DEBUG_PREEMPT is not set
CONFIG_DEBUG_RT_MUTEXES=y
CONFIG_DEBUG_SPINLOCK=y
CONFIG_DEBUG_MUTEXES=y
CONFIG_DEBUG_INFO=y
CONFIG_DEBUG_LL=y
CONFIG_DEBUG_SIRFMARCO_UART1=y
CONFIG_EARLY_PRINTK=y
# CONFIG_CRYPTO_ANSI_CPRNG is not set
# CONFIG_CRYPTO_HW is not set
CONFIG_CRC_CCITT=y
```
