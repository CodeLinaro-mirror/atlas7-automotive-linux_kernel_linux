## Documentation/devicetree/bindings/media/sirf-sdr.txt
```
SiRFSOC  sdr interface

Required properties:
 - compatible: suppose to be "sirf,atlas7-sdr"
 - reg: register base and size
 - interrupts: the interrupt number
 - dmas: dma channels
 - dma-names: dma transfer direction
 - clocks: input clock (see clock-bindings.txt)

Example:

	sdr@0x13010000 {
		compatible = "sirf,atlas7-sdr";
		reg = <0x13010000 0x1400>;
		interrupts = <0 7 0>,
			   <0 8 0>,
			   <0 9 0>;
		clocks = <&clks 134>;
		dmas = <&dmacsdrr 0>, <&dmacsdrw 0>;
		dma-names = "tx", "rx";
	};
```

## Documentation/devicetree/bindings/memory-controllers/memc-sirfsoc.txt
```
SiRFSoC Memory controller

Required properties:
- compatible: "sirf,atlas7-memc"
- reg: Address range of memc register set

Example:

	memory-controller@0x10800000 {
		compatible = "sirf,atlas7-memc";
		reg = <0x10800000 0x2000>;
	};

	memory-controller@0x10800000 {
		compatible = "sirf,prima2-memc";
		reg = <0x10800000 0x2000>;
	};

	memory-controller@0x10800000 {
		compatible = "sirf,marco-memc";
		reg = <0x10800000 0x2000>;
	};
```

## Documentation/devicetree/bindings/mfd/sirf-pwrc.txt
```
SiRFSoC Power Controller (PWRC) module

Power Controller is used to control the whole SoC power process.
The power controller controls the process of Power-On sequence,
Power-Off sequence, different power modes switching and power
status configuration. the pwrc is access by io bridge, so the
node's parent should be io bridge.

Required properties:
- compatible: "sirf,prima2-pwrc", or "sirf,atlas7-pwrc"
- reg: Address range of pwrc register set
- sysctl:mfd cell device of pwrc
- rtcm-clk:mfd cell device of pwrc
- onkey:mfd cell device of pwrc

Example:

pwrc@3000 {
	compatible = "sirf,atlas7-pwrc";
	reg = <0x3000 0x100>;
	sysctl {
		compatible = "sirf,sirf-sysctl";
	};

	rtcm-clk {
		compatible = "sirf,atlas7-rtcmclk";
	};

	onkey {
		compatible = "sirf,prima2-onkey";
	};
};

pwrc@3000 {
	compatible = "sirf,prima2-pwrc";
	reg = <0x3000 0x100>;
};
```

## Documentation/devicetree/bindings/misc/qca-rome-wifi.txt
```
QCA rome chip bt&wifi gpio configuration

Required properties:
- compatible: "sirf,rome_wifi"
- rome_gpio_1p8v_power: GPIO control for 1.8v power supply to QCA6574
- rome_gpio_3p3v_power: GPIO control for 3.3v power supply to QCA6574
- rome_gpio_bt_reset: GPIO control for RESET bt subsystem of QCA6574
- rome_gpio_wifi_reset: GPIO control for RESET wifi subsystem of QCA6574
- pinctrl-names: set to “default”
- pinctrl-0: configure gpio2 as the pwm function
- pwms: use pwm2 to output 32Khz clock for QCA6574


Example:
rome_power_gpio {
        compatible = "sirf,rome_wifi";
        rome_gpio_1p8v_power = <&gpio_1 76 1>; /* PIN:coex_pio_0 */
        rome_gpio_3p3v_power = <&gpio_1 77 1>; /* PIN:coex_pio_1 */
        rome_gpio_bt_reset = <&gpio_1 78 1>; /* PIN:coex_pio_2 */
        rome_gpio_wifi_reset = <&gpio_1 79 1>; /* PIN:coex_pio_3 */
        pinctrl-names = "default";
        pinctrl-0 = <&pw_i2s01_clk_pmx0>;
        pwms = <&pwm 6 30518>;
};
```

## Documentation/devicetree/bindings/misc/qca-rome.txt
```
QCA rome chip bt gpio configuration

Required properties:
- compatible: "sirf,rome"

Example:
bt {
        compatible = "sirf,rome";
        rome_gpio_1p8v_power = <&gpio_1 76 1>; /* PIN:coex_pio_0 */
        rome_gpio_3p3v_power = <&gpio_1 77 1>; /* PIN:coex_pio_1 */
        rome_gpio_bt_reset = <&gpio_1 78 1>; /* PIN:coex_pio_2 */
        pinctrl-names = "default";
        pinctrl-0 = <&pw_i2s01_clk_pmx0>;
        pwms = <&pwm 6 30518>;
};
```

## Documentation/devicetree/bindings/misc/sirf,atlas7-key-comparator.txt
```
Key Comparator to check keys press event on atlas7b

Required properties:
- compatible: "sirf,atlas7-key-comparator"
- reg: offset and length of the register set for the device

Example:
key_comparator: key_comparator@10E30030 {
	compatible = "sirf,atlas7-key-comparator";
	reg = <0x10E30030 0x8>;
};
```

## Documentation/devicetree/bindings/misc/sirf-a7ca_amber_wifi.txt
```
SIRF Soc a7ca_bt and amber wifi configuration

Required properties:
- compatible: "sirf,amber-9300" or "spidev"

Example:

amber_power_gpio {
    compatible = "sirf,amber-9300";
    amber9300_gpio_power = <&gpio_3 15 0>;
    amber9300_gpio_reset = <&gpio_1 76 0>;
};
```

## Documentation/devicetree/bindings/misc/sirf-a7ca_bt.txt
```
SIRF Soc a7ca_bt driver

Required properties:
- compatible: "sirf,a7ca_bt"
- clocks: The clock is needed by a7ca bt

Example:
a7ca_bt {
	compatible = "sirf,a7ca_bt";
	clocks = <&car 129>, <&car 137>, <&car 133>;
	clock-names="a7ca_btss","a7ca_btslow","a7ca_io";
};
```
