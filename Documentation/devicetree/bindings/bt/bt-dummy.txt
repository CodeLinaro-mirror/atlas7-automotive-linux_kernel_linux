## Documentation/devicetree/bindings/bt/bt-dummy.txt
```
Dummy bluetooth SCO and A2DP link codec

Required properties:
- compatible : "bt-sco", "bt-sco-a2dp"

Example:
	external_bt {
		compatible = "bt-sco-a2dp";
	};
```

## Documentation/devicetree/bindings/bt/bt-sirf.txt
```
CSR bluetooth chip

Required properties:
 - compatible : Should be "sirf,bt-9300" or "sirf,bt-8311-evb" or "sirf,a7ca_bt"

Optional properties:
 - bt_gpio_power : gpio number of power pin for external chip
   should be set when external chip is used
 - bt_gpio_reset : gpio number of reset pin for external chip
   should be set when external chip is used
 - clocks : Must contain an entry for each entry in clock-names.
   should be set when internal chip is used
   See ../clocks/clock-bindings.txt for details.
 - clock-names : list of clock names sorted in the same order as the clocks
   property. Must contain "a7ca_btss", "a7ca_btslow" and "a7ca_io".
   should be set when internal chip is used
   See ../clocks/clock-bindings.txt for details.

Example:
	external_bt {
		compatible = "sirf,bt-9300";
		bt_gpio_power = <&gpio_3 15 0>;
		bt_gpio_reset = <&gpio_1 76 0>;
	};

	internal_bt {
		compatible = "sirf,a7ca_bt";
		clocks = <&car 129>, <&car 137>, <&car 133>;
		clock-names="a7ca_btss","a7ca_btslow",
		"a7ca_io";
	};
```

## Documentation/devicetree/bindings/bus/atlas7-noc.txt
```
Device tree bindings for CSRatlas7 NoC(Network on Chip)

CSR atlas7 uses a NoC bus, SoC is splitted into mutiple MACROs. Every MACRO
holds some hardware modules. For each MACRO
properties:
- compatible : Should be "arteris, flexnoc"
- #address-cells: should be 1
- #size-cells: should be 1
- ranges : the child address space are mapped 1:1 onto the parent address space

Sub-nodes:
All the devices connected to noc are described using sub-node to noc. For
example, AUDMSCM MACRO includes multimediam nodes such as KAS, AC97, IACC, I2S,
USP0~3, LVDS.
For each MACRO, there is at least a noc service sub-node. This noc service
may provide bandwidth probe, transaction latency profile, error logger, QoS(
quality of service), register firewall(protect registers by region), target
firewall(protect registers by per-register).
Noc service sub-nodes:
properties:
- compatible : Should be one of
	"sirf,noc-macro", "sirf,atlas7-ntfw"
- reg: A resource specifier for the register space
- interrupts : Should be the interrupt number - optional
- regofs: define offset of NoC related registers
	for example:
	regofs = <&cpum 0x800 0x900 0x1050 0>;
	- macro: macro name
	- errlogoff: the offset of errlog register
	- faultenoff: the offset of fault enable register
	- regfwoff: the offset of register firewall register
	- schedoff: the offset of scheduler port register

There are spram firewalls in the system. They can detect illegal
hardware access to a7spram/m3sram for security protection.
if -regofs is not defined, that is the spram firewall.
```

## Documentation/devicetree/bindings/clock/atlas7-clock-audio.txt
```
Required properties:
- compatible: Should be "sirf,atlas7-audioclk"
- reg: Address and length of the register set
- #clock-cells: Should be <1>
- #reset-cells: Should be <1>

audioclk: clock-controller@10E30000 {
        compatible = "sirf,atlas7-audioclk";
        reg = <0x10E30000 0x400>;
        #clock-cells = <1>;
        #reset-cells = <1>;
};

adc: adc@10d80000 {
        compatible = "sirf,atlas7-adc";
        reg = <0x10d80000 0xffff>;
        interrupts = <0 34 0>;
        clocks = <&audioclk 0>;
};
```

## Documentation/devicetree/bindings/clock/sirf,virtio-clkc.txt
```
SIRF Virtio Clock Controller Binding
------------------------------------------------

Required properties :
- compatible : shall contain only one of the following:

			"sirf,virtio-clkc"
Example:
	vclkc {
		compatible = "sirf,virtio-clkc";
	};
```

## Documentation/devicetree/bindings/crypto/dx-cc.txt
```
Discretix crypto Module

Required properties:

- compatible : Should contain entries for this and backward compatible
  versions:
  - "dx,cc44p" for Discretix Public Crypto Public.
  - "dx,cc44s" for Discretix Public Crypto Secure.
- reg : Offset and length of the register set for the module
- interrupts : the interrupt-specifier for the module.
- clock : necessary clock for specficied device

Example:
	/* Discretix secure */
	dssec@53400000 {
		compatible = 'dx,cc44s';
		reg = <0x53400000 0xa0>;
		clock = <&clk 18>;
	};
	/* Discretix Public */
	dspub@53500000 {
		compatible = "dx,cc44p";
		reg = <0x53500000 0xa0>;
		interrupts = <102>;
	};
```

## Documentation/devicetree/bindings/hwlock/sirf,hwspinlock.txt
```
SIRF Hardware spinlock device Binding
-----------------------------------------------

Required properties :
- compatible : shall contain only one of the following:
	"sirf,hwspinlock"

- reg : the register address of hwspinlock

- base-id : the index of the first lock in this device

- num-spinlocks : how many spinlocks this device provides

- #hwlock-cells : hwlock users only use the hwlock id to represent a specific
	hwlock, so the number of cells should be <1> here.

Please look at the generic hwlock binding for usage information for consumers,
"Documentation/devicetree/bindings/hwlock/hwlock.txt"

Example of hwlock provider:
	hwlock {
		compatible = "sirf,hwspinlock";
		reg = <0x13240000 0x00010000>;
		#hwlock-cells = <1>;
		base-id = <0>;
		num-spinlocks = <30>;
	};

Example of hwlock users:
	node {
		...
		hwlocks = <&hwlock 2>;
		...
	};
```

## Documentation/devicetree/bindings/hwmon/sirfsoc_sensor.txt
```
Sirfsoc hwmon sensors
-------------------------------

Requires node properties:
- "compatible" value : one of
	"sirf,atlas7-sensor"
- "io-channels" value : adc channel index

Optional node properties:
- label : string describing the monitored value

Example:
	sirfsoc_sensor:sirfsoc_sensor {
		compatible = "sirf,atlas7-sensor";
		io-channels = <&adc 11>;
		io-channel-names = "temp";
		#thermal-sensor-cells = <1>;
	};
```

## Documentation/devicetree/bindings/iio/adc/atlas7_adc.txt
```
Sirfsoc Atlas7 inner Analog to Digital Converter

Required properties:
- compatible: Should contain "sirf,atlas7-adc"
- reg: Offset and length of the register set for the device
- interrupts: Should contain the interrupt for the device
- clocks: The clock is needed by the ADC controller
- #io-channel-cells: Should be set to <1>

Example:
adc: adc@10d80000 {
	compatible = "sirf,atlas7-adc";
	reg = <0x10d80000 0xffff>;
	interrupts = <0 34 0>;
	clocks = <&clks 56>;
	#io-channel-cells = <1>;
};
```

## Documentation/devicetree/bindings/iio/adc/sirfsoc_adc.txt
```
Sirfsoc inner Analog to Digital Converter bindings

The devicetree bindings are for the new ADC driver written for
Prima2/Atlas6 CSR.

Required properties:
- compatible: Should be one of
	* "sirf,prima2-adc": When use Prima2 SOC
	* "sirf,atlas6-adc": When use Atlas6 SOC
- reg: Offset and length of the register set for the device
- interrupts: Should contain the interrupt for the device
- clocks: The clock is needed by the ADC controller
- resets: The reset for the device
- #io-channel-cells: Should be set to <1>

Example:
	adc: adc@b0110000 {
		compatible = "sirf,prima2-adc";
		reg = <0xb0110000 0x10000>;
		interrupts = <34>;
		clocks = <&clks 16>;
		resets = <&rstc 32>;
		#io-channel-cells = <1>;
	};

	adc: adc@b0110000 {
		compatible = "sirf,atlas6-adc";
		reg = <0xb0110000 0x10000>;
		interrupts = <34>;
		clocks = <&clks 16>;
		resets = <&rstc 32>;
		#io-channel-cells = <1>;
	};
```

## Documentation/devicetree/bindings/input/sirf,atlas7-adc-keys.txt
```
sirfsoc atlas7 adc keys driver

The devicetree bindings are for Atlas7 adc keys driver

Required properties:
- compatible: should be "sirf,prima2-tsc"
- interrupt: touch controller interrupt
- io-channels: adc iio channels which ts data from
- io-channel-names: iio channels names
- max-press-volt: volt less then the value when key pressing
- linux,code: linux input code reported
- voltage: keys out voltage which readed from adc(mv)

adc-keys {
	compatible = "sirf,atlas7-adc-keys";
	interrupts = <0 32 0>;
	io-channels = <&adc 5>;
	io-channel-names = "adc_keys";
	max-press-volt = <2500>;

	button-s2 {
		label = "Volume Up";
		linux,code = <KEY_VOLUMEUP>;
		voltage = <1272>;
	};

	button-s7 {
		label = "Volume Down";
		linux,code = <KEY_VOLUMEDOWN>;
		voltage = <1211>;
	};

	button-s1 {
		label = "Brightness Up";
		linux,code = <KEY_BRIGHTNESSUP>;
		voltage = <1085>;
	};

	button-s4 {
		label = "Brightness Down";
		linux,code = <KEY_BRIGHTNESSUP>;
		voltage = <953>;
	};

	button-s5 {
		label = "Home";
		linux,code = <KEY_HOMEPAGE>;
		voltage = <1368>;
	};

	button-s6 {
		label = "Back";
		linux,code = <KEY_BACK>;
		voltage = <1416>;
	};
};
```

## Documentation/devicetree/bindings/input/touchscreen/ft5x06.txt
```
Ft5x06 touchscreen driver

The devicetree bindings are for Ft5x06 touchscreen.

Required properties:
- compatible: Should be "focaltech,ft5x06"
- interrupts: Should contain the interrupt for the device
- reg: the i2c address of the chip

Example:

ft5x06@38{
	compatible = "focaltech,ft5x06";
	interrupt-parent = <&gpio_3>;
	interrupts = <3 0x03>;
	reg = <0x38>;
};
```

## Documentation/devicetree/bindings/input/touchscreen/sirfsoc_ts.txt
```
* SIRFSOC Touch Screen

Required properties:
- compatible: should be "sirf,prima2-tsc"
- interrupt: touch controller interrupt
- io-channels: adc iio channels which ts data from
- io-channel-names: iio channels names

Example:
adc@b0110000 {
	tsc {
		compatible = "sirf,prima2-tsc";
		interrupts = <33>;
		io-channels = <&adc 0>, <&adc 1>;
		io-channel-names = "single_ts", "dual_ts";
	};
};

adc@b0110000 {
	tsc {
		compatible = "sirf,prima2-tsc";
		interrupts = <33>;
		io-channels = <&adc 0>;
		io-channel-names = "single_ts";
	};
};
```

## Documentation/devicetree/bindings/interrupt-controller/sirf,atlas7-pmipc.txt
```
SIRF Atlas7 Power Management Inter-Processor Communication (IPC) Device Binding

atlas7 SoC Power Management requres CPUs coordinate with one anther, thus
IPC is needed for Power Management coordinate.

INT_IPC_TRGT2_INIT0_INTR1 is used for this purpose, it is trigger by A7 to notify M3

Required properties:
- compatible: "sirf,atlas7-pmipc"
- reg: Address range of power management ipc register set

Example:

pmipc@0x13240000 {
	compatible = "sirf,atlas7-pmipc";
	reg = <0x13240000 0x00010000>;
};
```

## Documentation/devicetree/bindings/media/i2c/it68013.txt
```
* ITE TECH it61083 hdmi decoder

The it61083 device supports decoding video and audio signal of hdmi.
it support the 8bit DDR data bus.

Required properities
 - compatible: subdevice compatible node, decoder:"itetech,it68013"
				or "itetech,edid"
 - reg: subdevice register size
 - input-number: number of the functions of this subdevice
 - inputs: the functions phandle name
 - input-name: description for the function name of the subdevice
 - input-id: the index of the function, its rangs is input-number - 1
 - remote-endpoint:phandle to an 'endpoint' subnode of a remote device
 node. It is defined in video-interfaces.txt
 - data-mode: the data bus mode,DDR or SDR mode.
 - data-shift: define the data bus mapping.

Other properties for atlas7 SoC:
 - clocks: input clock (see clock-bindings.txt)

Example:
	vip1@13160000 {
		status = "okay";
		pinctrl-names = "default";
		pinctrl-0 = <&vi_vip1_pmx>;
		port {
			#address-cells = <1>;
			#size-cells = <0>;
			vip1_0: endpoint@0 {
				reg = <0>;
				remote-endpoint = <&it68013_1>;
			};
		};
	};
	it68013: decoder@49 {
		compatible = "itetech,it68013";
		reg = <0x49>;
		/*hp-hdmiinput-gpios = <&gpio_3 5 0>;*/
		input-number = <1>;
		inputs = <&hdmi0>;
		hdmi0: hdmi@0 {
			input-name = "hdmi";
			input-id = <0>;
		};
		port {
			it68013_1: endpoint {
				/* SDR or DDR sample
					mode */
				data-mode = "DDR";
				/* 0: 16bit data to
					VIP */
				/* 1: 8bit to VIP
					data[7:0] */
				/* 2: 8bit to VIP
					data[8:1] */
				/* 3: ... */
				data-shift = <1>;
				remote-endpoint =<&vip1_0>;
			};
		};
	};
	it68013_edid@54 {
		compatible = "itetech,edid";
		reg = <0x54>;
	};
```

## Documentation/devicetree/bindings/media/sirf-camera.txt
```
SiRFSOC camera host interface

Required properties:
 - compatible: suppose to be one of "sirf,prima2-vip", "sirf,atlas7-vip0", if
 it is included in rearview pipe line then should add "sirf,rv-vip"
 - reg: register base and size
 - interrupts: the interrupt number
 - dmas: dma channels, atlas7 SoC needn't this
 - dma-names: dma transfer direction(receive), atlas7 SoC needn't this
 - sirf,vip_cma_size: the cma memory size used by vip host driver
 - any other required properties defined in video-interfaces.txt

Optional properties:
 - clocks: input clock (see clock-bindings.txt)

Example:

	vip@b00C0000 {
		compatible = "sirf,prima2-vip";
		status = "okay";
		pinctrl-names = "default";
		pinctrl-0 = <&vip_pins_a>;
		reg = <0xb00C0000 0x10000>;
		clocks = <&clks 31>;
		interrupts = <14>;
		dmas = <&dmac1 0>;
		dma-names = "rx";
		sirf,vip_cma_size = <0xC00000>;
		port {
			#address-cells = <1>;
		        #size-cells = <0>;
		        vip0_0: endpoint@0 {
				reg = <0>;
				remote-endpoint = <&tw9900_1>;
				data-shift = <1>;       /* select pxd_data[7:0] as valid data */
		        };
		};
	};

	vip0@10db0000 {
		compatible = "sirf,atlas7-cvd-vip", "sirf,rv-vip";
		reg = <0x10db0000 0x2000>;
		interrupts = <0 85 0>;
		sirf,vip_cma_size = <0xC00000>;
	};
	vip1@13160000 {
		compatible = "sirf,atlas7-com-vip";
		reg = <0x13160000 0x1000>;
		clocks = <&car 74>;
		interrupts = <0 63 0>, <0 84 0>;
		sirf,vip_cma_size = <0x1A00000>;
	};

SiRFSOC camera subdevice interface

Required properities
 - compatible: subdevice compatible node, decoder:"technwell,tw9900"
				or atlas7 SoC inside decoder "sirf,cvd"
 - reg: subdevice register size
 - input-number: number of the functions of this subdevice
 - inputs: the functions phandle name
 - input-name: description for the function name of the subdevice
 - input-id: the index of the function, its rangs is input-number - 1
 - remote-endpoint:phandle to an 'endpoint' subnode of a remote device
 node. It is defined in video-interfaces.txt

Other properties for atlas7 SoC:
 - clocks: input clock (see clock-bindings.txt)

Example:

	i2c0: i2c@b00e0000 {
		...

		tw9900: decoder@44 {
			compatible = "techwell,tw9900";
			reg = <0x44>;
			input-number = <2>;
			inputs = <&cvbs0 &cvbs1>;
			cvbs0: cvbs@0 {
				input-name = "camera";
				input-id = <0>;
			};
			cvbs1: cvbs@1 {
				input-name = "dvd";
				input-id = <1>;
			};
			port {
				tw9900_1: endpoint {
					remote-endpoint = <&vip0_0>;
				};
			};
		};

		...
	};

	cvd@10db2000 {
		compatible = "sirf,cvd";
		reg = <0x10db2000 0x2000>;
		clocks = <&clks 53>;
	};

SiRFSOC rearview virtual device interface

Required properities
 - compatible: should be "sirf,rearview"
 - status: set "okay" to enable, "disable" to disable rearview module
 - rearview-gpios: dedicated gpio pin to trigger rearview
 - mirror: set non-zero value to enable horizontal mirror function
 - source-std: point out the input signal standard, NTSC or PAL
 - display-panel: display rearview picture on which panel

Example:

	sirf-rearview {
			compatible = "sirf,rearview";
			status = "okay";
			rearview-gpios = <&gpio_1 1 0>;
			mirror = <0>;
			source-std = "NTSC";		/* NTSC or PAL */
			display-panel = "display0";	/* display0 or display1 */
		};
```

## Documentation/devicetree/bindings/media/sirf-mjpeg.txt
```
sirf SoC MJPEG codec

Required properties:

- compatible	: should be "sirf,jpeg";
- reg		: register base and size;
- interrupts	: the interrupt number;
- clocks        : input clock (see clock-bindings.txt)
Example:

	jpeg@17000000 {
		compatible = "sirf,atlas7-jpeg";
		reg = <0x17000000 0x10000>;
		interrupts = <0 72 0>,
				<0 73 0>;
		clocks = <&car 103>;
	};
```
