## Documentation/devicetree/bindings/misc/sirf-hs_i2s.txt
```
CSRatlas7 SoC high speed i2s (HS-I2S)

Required properties:
- compatible: "sirf,atlas7-hsi2s"
- reg: register base and size
- interrupts: the interrupt number
- dmas: dma channels
- dma-names: dma transfer direction
- clocks: input clock (see clock-bindings.txt)

Example:

	hsi2s0: i2s0@133d0000 {
		cell-index = <0>;
		compatible = "sirf,atlas7-hsi2s";
		reg = <0x133d0000 0x100>;
		interrupts = <0 114 0>;
		clocks = <&car 71>;
		dmas = <&dmac1 0>;
		dma-names = "rx";
		status = "disabled";
	};
```

## Documentation/devicetree/bindings/misc/sirf-pulsec.txt
```
SIRF Soc inner pulse counter

Required properties:
- compatible: "sirf,prima2-pulsec"
- reg: Offset and length of the register set for the device
- clocks: The clock is needed by the pulse counter
- interrupts: Should contain the interrupt for the device

Example:
pulsec@10d90000 {
	compatible = "sirf,prima2-pulsec";
	reg = <0x10d90000 0xffff>;
	interrupts = <0 48 0>;
	clocks = <&car 55>;
};
```

## Documentation/devicetree/bindings/misc/sirf-ts.txt
```
CSRatlas7 SoC USP TS module

Required properties:
- compatible: "sirf,atlas7-usp_ts"

Example:

	usp2: usp@10d40000 {
		compatible = "sirf,atlas7-usp_ts";
		status = "okay";
		pinctrl-0 = <&audio_uart2_urfs_pmx2
			&audio_uart2_urxd_pmx2
			&audio_uart2_usclk_pmx2
			&audio_uart2_utfs_pmx2
			&audio_uart2_utxd_pmx2>;
		pinctrl-names = "default";
	};

CSRatlas7 SoC VIP TS module

Required properties:
- compatible: "sirf,atlas7-vip_ts"

Example:

	vip1@13160000 {
		compatible = "sirf,atlas7-vip_ts";
		status = "okay";
		pinctrl-names = "default";
		pinctrl-0 = <&vi_vip1_low8bit_pmx>;
	};
```

## Documentation/devicetree/bindings/mmc/sdhci-sirf.txt
```
* SiRFprimII/marco/atlas6 SDHCI Controller

This file documents differences between the core properties in mmc.txt
and the properties used by the sdhci-sirf driver.

Required properties:
- compatible: sirf,prima2-sdhc

Optional properties:
- cd-gpios: card detect gpio, with zero flags.

Example:

	sd0: sdhci@56000000 {
		compatible = "sirf,prima2-sdhc";
		reg = <0xcd000000 0x100000>;
		cd-gpios = <&gpio 6 0>;
	};


* SiRFatlas7 SDHCI Controller

This file documents differences between the core properties in mmc.txt
and the properties used by the sdhci-sirf driver.

Required properties:
- compatible: sirf,atlas7-sdhc
- clocks: A list of phandle + clock-specifier pairs for the clocks listed in clock-names.
- clock-names: Should contain the following:
	"iface" - SDPHY clock (required)
	"core"	- SDHCI clock (required)

Optional properties:
- cd-gpios: card detect gpio, with zero flags.

Example:

	sd1: sdhci@16100000 {
		compatible = "sirf,atlas7-sdhc";
		reg = <0x16100000 0x100000>;
		clocks = <&clks 116>, <&clks 118>;
		clock-names = "core", "iface";
	};
```

## Documentation/devicetree/bindings/mtd/atlas7_qspi.txt
```
* CSR CSRatlas7 Quad Serial Peripheral Interface for Nor flash

Required properties:
- compatible : Should be "sirf,atlas7-qspi-nor"
- reg : Offset and length of the register set for the device
- interrupts : Should contain QSPI interrupt
- #address-cells, #size-cells : Must be present if the device has sub-nodes
- pinctrl: pin max name
- clock-rate : Functional clock rate of QSPI in Hz

Example:
	qspi: flash@188B0000 {
		cell-index = <0>;
		compatible = "sirf,atlas7-qspi-nor";
		reg = <0x188B0000 0x10000>;
		interrupts = <0 15 0>;
		#address-cells = <1>;
		#size-cells = <0>;
		pinctrl-names = "default";
		pinctrl-0 = <&sp0_qspi_pmx>;
		clock-rate = <20000000>;	/* 20MHz */

		flash: micron@0{
			...
		};
	};
```

## Documentation/devicetree/bindings/nanddisk/sirf.txt
```
CSR prima2/marco/atlas6 NAND Controller

Required Properties:
- compatible : Should be "sirf,prima2-nand" or "sirf,atlas7-nand"
- reg : Address range of controller
- pinctrl-names : The name of pinctrl
- pinctrl-0 : = The pinctrl needed by NAND controller
- sirf,nand-dma-channel : The DMA channel needed by NAND controller
- interrupts : The NAND interrupt specification
- clocks : The clocks needed by the NAND controller
- sirf,nanddisk-rsvmem-range : The space will be reserved by NAND controller
                               the first contains the space start address,
			       the second contains the space length

Example:

nand@b0030000 {
	compatible = "sirf,prima2-nand";
	reg = <0xb0030000 0x10000>;
	pinctrl-names = "default";
	pinctrl-0 = <&nand_pins_a>;
	sirf,nand-dma-channel = <8>;
	interrupts = <41>;
	clocks = <&clks 26>;
	sirf,nanddisk-rsvmem-range = <0x6000000 0x200000>;
};
```

## Documentation/devicetree/bindings/net/dwc-eth-qos.txt
```
* Synopsys DWC Ethernet QOS CORE

dwc-eth-qos- EMAC(10/100/1000Mbps)

Required properties:
 - compatible: must be "snps, dwc-eth-qos"
 - reg : address and length of the register set for the device
 - interrupts: the EMAC interrupts
 - clocks: reference to the clock supplying the EMAC
 - phy-mode: set the PHY mode

Examples:

	gmac: eth@180b0000 {
		compatible = "snps, dwc-eth-qos";
		reg = <0x180b0000 0x4000>;
		interrupts = <0 59 0>;
		interrupt-names = "macirq";
		clocks = <&car 39>, <&car 45>,
		       <&car 86>, <&car 87>;
		clock-names = "gnssm_rgmii", "gnssm_gmac",
			"rgmii", "gmac";
		local-mac-address = [00 00 00 00 00 00];
		phy-mode = "rgmii";
	};
```

## Documentation/devicetree/bindings/power/atlas7-gps.txt
```
atlas7 gps module

atlas7 gps control is by pwrc iobg interface, thus can be
controlled by A7 by existing regmap interface.

Required properties:
- compatible: "sirf,atlas7-gps"

Example:

atlas7-gps {
	compatible = "sirf,atlas7-gps";
};
```

## Documentation/devicetree/bindings/power/retain-reg.txt
```
SiRFSoC retain register module

regtain registers is on always power on domain, thus can be
used after hibernation or deep sleep.

Required properties:
- compatible: "sirf,atlas7-retain"
- reg: Address range of retain register set

Example:

retain@0x188D0000 {
	compatible = "sirf,atlas7-retain";
	reg = <0x188D0000 0x80>;
};
```

## Documentation/devicetree/bindings/pwm/pwm-sirf.txt
```
SiRF prima2 & atlas6 PWM drivers

Required properties:
- compatible: "sirf,prima2-pwm"
- reg: physical base address and length of the controller's registers
- #pwm-cells: should be 2. See pwm.txt in this directory for a description of
  the cells format.
- clocks: Must contain an entry for each entry in clock-names.
  See ../clock/prima2-clock.txt for details.
- clock-names: Must include the following entries:
  of clock sources to generate PWM signal,
  - pwmc: PWM controller clock
  - sigsrc0: source clock 0 for PWM
  - sigsrc1: source clock 1 for PWM
  - sigsrc2: source clock 2 for PWM
  - sigsrc3: source clock 3 for PWM
  - sigsrc4: source clock 4 for PWM

Example:

pwm: pwm@b0130000 {
	compatible = "sirf,prima2-pwm";
	#pwm-cells = <2>;
	reg = <0xb0130000 0x10000>;
	clocks = <&clks 21>, <&clks 1>, <&clks 2>,
	       <&clks 3>, <&clks 0>, <&clks 4>;
	clock-names = "pwmc", "sigsrc0", "sigsrc1",
		"sigsrc2", "sigsrc3", "sigsrc4";
};
```

## Documentation/devicetree/bindings/regulator/atlas7-pmu.txt
```
CSR Atlas7 internal LDO regulator

Required properties:
- compatible: "sirf,atlas7-analog-ldo"
- reg: register phyical address
- ldo: A node that houses a sub-node for the ldo regulator within the
  device.
  The content of each sub-node is defined by the standard binding for
  regulators; see regulator.txt.

Example:
	analog_regulator: analog_regulator@10E30000 {
		compatible = "sirf,atlas7-analog-ldo";
		status = "disabled";
		reg = <0x10E30000 0x100>;
		ldo0: ldo0 {
			regulator-name = "ldo0";
			regulator-min-microvolt = <1800000>;
			regulator-max-microvolt = <1800000>;
		};
		ldo1: ldo1 {
			regulator-name = "ldo1";
			regulator-min-microvolt = <2500000>;
			regulator-max-microvolt = <2500000>;
		};
		ldo2: ldo2 {
			regulator-name = "ldo2";
			regulator-min-microvolt = <1800000>;
			regulator-max-microvolt = <1800000>;
		};
	};
```

## Documentation/devicetree/bindings/remoteproc/sirf,remoteproc.txt
```
SIRF Atlas7 Remote processor Device Binding
------------------------------------------------
1) Main node
	Required properties :

	- compatible : "sirf,atlas7-rproc"

	- reg : register address of remoteproc device

	- interrupts: the irq number this rproc need to handle.

	- hwlocks: the hwlocks this rproc to used to protect data
	  between two processors.

	- memory-region: the memory region, which is used to store virtual
	  device info, fifo buffers and share memory between two processors.

	- firmware: the firmware file that will be loaded to remote processor.

Please refer to ../reserved-memory/reserved-memory.txt for details of the
memory-region bindings.
Please refer to ../hwlock/hwlock.txt for details of the hwlock bindings.

2) Example:
			ns_m3_rproc@0 {
				compatible = "sirf,atlas7-rproc";
				reg = <0x13240108 0x4>,
					<0x13240208 0x4>;
				interrupts = <0 123 0>;
				hwlocks = <&hwlock 0>, <&hwlock 1>;
				memory-region = <&ipc_mem0>;
				firmware = "RTOSDemo.bin";
			};
```

## Documentation/devicetree/bindings/reserved-memory/sirf,reserved-memory.txt
```
SIRF Soc Reserved memory Binding
------------------------------------------------
This is the node describes the Reserved memory range of sirfsoc.

- compatible : "sirf,reserved-memory".

The "reserved memory node" mentioned above must conform to the bindings
described in ./reserved-memory.txt.
```

## Documentation/devicetree/bindings/rtc/rtc-sirfsoc.txt
```
SiRFSoC Real Time Clock

Required properties:
- compatible: "sirf,prima2-sysrtc"
- reg: Address range of rtc register set
- interrupts: rtc Alarm0, rtc TIC, rtc Alarm1 interrupts in order

Example:

sysrtc@2000 {
	compatible = "sirf,prima2-sysrtc";
	reg = <0x2000 0x1000>;
	interrupts = <52 53 54>;
};
```

## Documentation/devicetree/bindings/sound/csr,kalimba-ipc.txt
```
CSR Kalimba IPC

Kalimba IPC deals with inter-processores communication hardware interface.

Required properties:

  - compatible		: Contains "csr,kalimba-ipc".

  - reg			: Offset and length of register set for kalimba and IPC.

  - interrupts		: Contains the IPC interrupt.

Example:

kalimba_ipc@13240000 {
	compatible = "csr,kalimba-ipc";
	reg = <0x10C10000 0x1000>,
		<0x13240000 0x500>;
	interrupts = <0 118 0>;
};
```

## Documentation/devicetree/bindings/sound/csr,kalimba.txt
```
CSR Kalimba DSP

Kalimba DSP deals with audio signal processing such as sample rate converting,
mixing, post processing, echo cancel, noise reduction, etc.

Required properties:

  - compatible		: Contains "csr,kalimba-dsp".

  - clocks		: Contains an entry for each entry in clock-names.

  - clock-names		: Contains required clock names.

  - resets		: Contains reset unit.

Example:

kalimba {
	compatible = "csr,kalimba";
	clocks = <&car 55>, <&car 26>, <&car 31>;
	clock-names = "kas_kas", "audmscm_nocd", "gpum_nocd";
	resets = <&car 10>;
};
```

## Documentation/devicetree/bindings/sound/csr,kas-audio.txt
```
CSR Kalimba Sound Card

Required properties:

  - compatible		: "csr,kas-audio".

Example:

kas-sound-card {
	compatible = "csr,kas-audio";
};
```

## Documentation/devicetree/bindings/sound/csr,kas-pcm.txt
```
CSR Kalimba PCM front end driver

Required properties:

  - compatible		: "csr,kas-pcm".

Example:

kas-pcm {
	compatible = "csr,kas-pcm";
};
```

## Documentation/devicetree/bindings/sound/sirf-atlas7-codec.txt
```
SiRF Atlas7 internal audio CODEC

Required properties:
  - compatible : "sirf,atlas7-codec"
  - reg : the register address of the device.
  - clocks: the clock of SiRF internal audio codec.
  - ldo-supply: The LDO regulator supply for codec.

Example:
	atlas7_codec: atlas7_codec@10E30000 {
		#sound-dai-cells = <0>;
		compatible = "sirf,atlas7-codec";
		reg = <0x10E30000 0x400>;
		clocks = <&audioclk 0>;
		ldo-supply = <&ldo>;
	};
```

## Documentation/devicetree/bindings/sound/sirf-atlas7-iacc.txt
```
* SiRF Atlas7 internal audio codec controller

Required properties:
- compatible: "sirf,atlas7-iacc"
- reg: Base address and size entries:
- dmas: List of DMA controller phandle and DMA request line ordered pairs.
- dma-names: Identifier string for each DMA request line in the dmas property.
  These strings correspond 1:1 with the ordered pairs in dmas.

  One of the DMA channels will be responsible for transmission (should be
  named "tx0", "tx1", "tx2" and "tx3" for each channels) and one for
  reception (should be named "rx").

Example:
	atlas7_iacc: atlas7_iacc@10D01000 {
		#sound-dai-cells = <0>;
		compatible = "sirf,atlas7-iacc";
		reg = <0x10D01000 0x100>;
		dmas = <&dmac3 0>, <&dmac3 7>, <&dmac3 8>, <&dmac3 3>, <&dmac3 9>;
		dma-names = "rx", "tx0", "tx1", "tx2", "tx3";
		clocks = <&car 69>;
};
```

## Documentation/devicetree/bindings/sound/sirf-bt-sco.txt
```
* SiRF atlas6/prima2 and bt-sco based audio setups

Required properties:
- compatible: "sirf,sirf-bt-sco"
- sirf,usp-controller: The phandle of the SiRF usp controller.

Optional properties:
- bt-sco-master: The phandle of who is master, if set,
  the codec is master, Otherwiss, the soc is master.

Example:

sirf-bt-sco {
	compatible = "sirf,sirf-bt-sco";
	sirf,usp-controller = <&usp0>;
	bt-sco-master;
};
```

## Documentation/devicetree/bindings/sound/sirf-hdmi.txt
```
* SiRF atlas6/prima2/atlas7 hdmi audio codec based audio setups

Required properties:
- compatible:
  * "sirf,sirf-hdmi"
  * "sirf,hdmi-card": three output lines
  * "sirf,hdmi-card-olm": one output line
- sirf,i2s-controller: The phandle of the SiRF I2S controller.
- sirf,hdmi-audio-codec: The phandle of the hdmi audio codec.

Example:

hdmi: hdmi {
	compatible = "hdmi-audio-codec";
};
sirf-hdmi {
	compatible = "sirf,hdmi-card";
	sirf,i2s-controller = <&i2s>;
	sirf,hdmi-audio-codec = <&hdmi>;
};
```

## Documentation/devicetree/bindings/usb/ci-hdrc-sirf.txt
```
* CSRatlas7 (formerly SiRF Atlas7) ChipIdea USB Controllers

Required properties:
- cell-index: index of ci_hdrc_platform_data array
- compatible: Should be "sirf,atlas7-usb"
- reg: Should contain registers location and length
- interrupts: Should contain controller interrupt
- sirf,usbphy: phandle of usb phy that connects to the port
- clocks: the clock feeding the controller clock

Recommended properies:
- phy_type: the type of the phy connected to the core. Should be one
  of "utmi", "utmi_wide", "ulpi", "serial" or "hsic". Without this
  property the PORTSC register won't be touched
- dr_mode: One of "host", "peripheral" or "otg". Defaults to "otg"

Optional properties:
- maximum-speed: limit the maximum speed in Gadget role

Examples:
usb0: usb@17060000 {
	cell-index = <0>;
	compatible = "sirf,atlas7-usb";
	reg = <0x17060000 0x200>;
	interrupts = <0 10 0>;
	clocks = <&clks 120>;
	sirf,usbphy = <&usbphy0>;
	phy_type = "utmi";
	dr_mode = "otg";
	maximum-speed = "high-speed";
};
```

## Documentation/devicetree/bindings/usb/sirf-phy.txt
```
* CSRatlas7 (formerly SiRF Atlas7) USB PHY

Required properties:
- compatible: Should be "sirf,atlas7-usbphy"
- reg: Should contain registers location and length
- clocks: the clock feeding the PHY clock

Example:
usbphy0: usbphy@0 {
	compatible = "sirf,atlas7-usbphy";
	reg = <0x17060200 0x100>;
	clocks = <&clks 122>;
};
```

## Documentation/devicetree/bindings/vdec/a7da-vxd.txt
```
CSR prima2/atlas7 VXD

Required Properties:
- compatible : Should be "sirf,prima2-video-codec" or "sirf,atlas7-video-codec"
- reg : Address range of controller
- interrupts : The VXD interrupt specification
- clocks : The clocks needed by the VXD

Example:

multimedia@15000000 {
	compatible = "sirf,atlas7-video-codec";
	reg = <0x15000000 0x10000>;
	interrupts = <0 5 0>;
	clocks = <&car 109>;
};
```
