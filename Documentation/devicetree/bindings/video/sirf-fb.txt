## Documentation/devicetree/bindings/video/sirf-fb.txt
```
SirfSoc FrameBuffer
-----------------------------------------------------

Required properties:
- compatible : "sirf,prima2-lcd"
- reg : should contain 1 register ranges(address and length).
- interrupts : lcd controller interrupt.
- display: a handle pointing to the display node.
- reset-bit: lcd reset index in the SOC reset controller.
Required nodes:
- clock: lcd clock index in the SOC clock system.
- display: a display node is required to initialize the lcd panel
	This should be in the board dts.
- default-panel: panel within the display with timing parameters.

Example:
        lcd@90010000 {
		compatible = "sirf,prima2-lcd";
		reg = <0x90010000 0x20000>;
		interrupts = <30>;
		clocks = <&clks34>;
		display=<&display>;
		reset-bit = <5>;
		/* later transfer to pwm */
		bl-gpio	= <&gpio 7 0>;
		default-panel = <&panel0>;
	};

SirfSoc Atlas6 Display
-----------------------------------------------------
Required properties:
 - panel-name: the panel name used on the board
 - hactive, vactive: the Display resolution
 - left-margin, right-margin, hsync-len: Horizontal Display timing parameters
   in pixels
   upper-margin, lower-margin, vsync-len: Vertical Display timing parameters in
   lines
 - pixclock: lcd panel pixel clock
 - timing: panel timing control, can set to PCLK_POLAR,PCLK_EDGE,
	HSYNC_POLAR,VSYNC_POLAR

Example:

	display@0 {
            panels {
                panel0: panel@0 {
                        panel-name = "Innolux TFT";
                        hactive = <800>;
                        vactive = <480>;
                        left-margin = <20>;
                        right-margin = <234>;
                        upper-margin = <3>;
                        lower-margin = <41>;
                        hsync-len = <3>;
                        vsync-len = <2>;
                        pixclock = <33264000>;
                        timing = <0x88>;
                        };
            };
        };
```

## Documentation/devicetree/bindings/video/sirf-vdss.txt
```
SirfSoc Video Display Subsystem
========================================

Generic Description
-------------------

This document is a generic description of the Video Display Subsystem(VDSS)
bindings.

The Video Display Subsystem hardware consists of LCDC module(layer,screen
and overlay control) and a number of output modules.

LCDC is the lcd controller, which contains layer, screen and overlay control
hardware logic, and it reads pixels from the memory and outputs a RGB or YUV
pixel stream to the outputs.

The output modules like rgb panel, HDMI or LVDS panel receiving RGB/YUV pixel stream.

SirfSoc Video Display Subsystem device tree properties
-----------------------------------------------------

SirfSoc LCDC:

Required properties:
- compatible : "sirf,lcdc", or "sirf,atlas7-lcdc" for atlas7 platform
- reg : should contain 1 register ranges(address and length).
- interrupts : lcd controller interrupt.
- reset-bit: lcd reset index in the SOC reset controller.
Required nodes:
- clock: lcd clock index in the SOC clock system.

Example:
  lcd@90010000 {
	compatible = "sirf,lcdc";
	reg = <0x90010000 0x20000>;
	interrupts = <30>;
	clocks = <&clks 34>;
	resets = <&rstc 5>;
  };

SirfSoc LVDSC:

Required properties:
- compatible : "sirf,atlas7-lvdsc" only for atlas7 platform,
- reg : should contain 1 register ranges(address and length).
- interrupts : lvds controller interrupt.
- reset-bit: lvds reset index in the SOC reset controller.
Required nodes:
- clock: lvds clock index in the SOC clock system.

Example:
  lvds@10e10000 {
	compatible = "sirf,atlas7-lvdsc";
	reg = <0x10e10000 0x10000>;
	interrupts = <0 64 0>;
	clocks = <&car 61>;
	reset = <&car 60>;
  };

SirfSoc VPP:

Required properties:
- compatible : "sirf,prima2-vpp", or "sirf,atlas7-vpp" for atlas7 platform
- reg : should contain 1 register ranges(address and length).
- interrupts : vpp interrupt.
- reset-bit: vpp reset index in the SOC reset controller.
Required nodes:
- clock: vpp clock index in the SOC clock system.

Example:
  vpp@90020000 {
	  compatible = "sirf,prima2-vpp";
	  reg = <0x90020000 0x10000>;
	  interrupts = <31>;
	  clocks = <&clks 35>;
	  resets = <&rstc 6>;
  };

SirfSoc DCU:

Required properties:
- compatible : "sirf,atlas7-dcu" for atlas7 platform
- reg : should contain 2 register ranges(address and length).
- interrupts : dcu interrupt.
Required nodes:
- clock: dcu clock index in the SOC clock system.

Example:
  dcu@13220000 {
	  compatible = "sirf,atlas7-dcu";
	  reg = <0x13220000 0x10000>,
	      <0x132c0000 0x10000>;
	  interrupts = <0 96 0>;
	  clocks = <&car 93>;
  };

SirfSoc Panel Control:

Required properties:
- compatible : "sirf,lcd-mcu"
- reg : should contain 1 register ranges(address and length).

Example:
lcd_mcu: lcd_mcu@40{
	compatible = "sirf,lcd-mcu";
	reg = <0x40>;
  };

SirfSoc display and the timing:

Required properties:
 - compatible: specify the panel type
 - source: 	the output source of the lcdc
 - panel-ctrl: the mcu to power on/off the panel through i2c bus
 - data-lines: available data pins from the lcdc controller to panel
 - display-timings: display timing properties of the panel

Optional properties:
 - vcc-gpios: panel power vcc gpio control, because some socs only have
   hardware logic to control VDD and VEE, the VCC is controlled by GPIOs.
 - power-vdd: panel power vdd control, high word for vdd enable,low word
   for vdd disable
 - power-vee: panel power vee control, high word for vee enable,low word
   for vee disable
 - power-vcc: panel power vcc control, high word for vcc enable,low word
   for vcc disable

See Documentation/devicetree/bindings/video/display-timing.txt for generic
description about display timing properties.

An example of vdss panel(rgb interface) control parameters and the display timing properties:

display0: display@0 {
	compatible = "tm,WSVGA-panel", "rgb-panel";
	source = "rgb.0";

	panel-ctrl = <&lcd_mcu>;

	vcc-gpios = <&gpio 4 0>;
	power-vdd  = <0x00160015>;
	power-vee  = <0x00180017>;
	data-lines = <18>;

	display-timings {
	        native-mode = <&timing0>;
	        timing0: timing0 {
			clock-frequency = <51200000>;
	                hactive = <1024>;
	                vactive = <600>;
	                hfront-porch = <288>;
	                hback-porch = <28>;
	                hsync-len = <4>;
	                vback-porch = <8>;
	                vfront-porch = <24>;
	                vsync-len = <3>;
	                hsync-active = <0>;
	                vsync-active = <0>;
	                de-active = <0>;
	                pixelclk-active = <0>;
	        };
	};
};

An example of vdss panel(rgb interface, but the output is HDMI) control parameters and the display timing properties:
while one requirement is one HDMI transmitter node(itetech,it661x) in i2c section is needed:

it661x: it661x_transmitter_chip@4d {
	compatible = "itetech,it661x";
	reg = <0x4D>;
};

display0: display@0 {
	compatible = "tm,WSVGA-panel", "hdmi-panel";
	source = "rgb.0";

	data-lines = <24>;

	display-timings {
	        native-mode = <&timing0>;
	        timing0: timing0 {
			clock-frequency = <51200000>;
	                hactive = <1024>;
	                vactive = <600>;
	                hfront-porch = <288>;
	                hback-porch = <28>;
	                hsync-len = <4>;
	                vback-porch = <8>;
	                vfront-porch = <24>;
	                vsync-len = <3>;
	                hsync-active = <0>;
	                vsync-active = <0>;
	                de-active = <0>;
	                pixelclk-active = <0>;
	        };
	};
};

Another example of vdss panel(lvds interface) control parameters and the display timing properties:

display0: display@0 {
	compatible = "innolux,WSVGA-panel", "lvds-panel";
	source = "lvds.0";

	data-lines = <24>;

	display-timings {
	        native-mode = <&timing0>;
	        timing0: timing0 {
			clock-frequency = <60000000>;
	                hactive = <1024>;
	                vactive = <600>;
	                hfront-porch = <220>;
	                hback-porch = <100>;
	                hsync-len = <1>;
	                vback-porch = <10>;
	                vfront-porch = <25>;
	                vsync-len = <1>;
	                hsync-active = <0>;
	                vsync-active = <0>;
	                de-active = <1>;
	                pixelclk-active = <1>;
	        };
	};
};
```

## arch/arm/configs/prima2_defconfig
```kconfig
#
# CONFIG_LOCALVERSION_AUTO is not set
#
# Copyright (c) 2012-2016, The Linux Foundation. All rights reserved.
#
# This program is free software; you can redistribute it and/or modify
# it under the terms of the GNU General Public License version 2 and
# only version 2 as published by the Free Software Foundation.
#
# This program is distributed in the hope that it will be useful,
# but WITHOUT ANY WARRANTY; without even the implied warranty of
# MERCHANTABILITY or FITNESS FOR A PARTICULAR PURPOSE.  See the
# GNU General Public License for more details.
#

CONFIG_KERNEL_LZO=y
CONFIG_SYSVIPC=y
CONFIG_POSIX_MQUEUE=y
CONFIG_NO_HZ=y
CONFIG_HIGH_RES_TIMERS=y
CONFIG_CGROUPS=y
CONFIG_CC_OPTIMIZE_FOR_SIZE=y
CONFIG_EXPERT=y
CONFIG_PERF_EVENTS=y
# CONFIG_SLUB_DEBUG is not set
CONFIG_CC_STACKPROTECTOR=y
CONFIG_CC_STACKPROTECTOR_STRONG=y
CONFIG_MODULES=y
CONFIG_MODULE_UNLOAD=y
# CONFIG_BLK_DEV_BSG is not set
CONFIG_ARCH_SIRF=y
CONFIG_A7DA_PM_PWRC_DEBUG=y
CONFIG_A7DA_PM_SYSRTC_DEBUG=y
CONFIG_SMP=y
CONFIG_NR_CPUS=2
CONFIG_PREEMPT=y
CONFIG_AEABI=y
CONFIG_HIGHMEM=y
CONFIG_CMA=y
CONFIG_ZBOOT_ROM_TEXT=0x0
CONFIG_ZBOOT_ROM_BSS=0x0
CONFIG_KEXEC=y
CONFIG_CPU_FREQ=y
CONFIG_CPU_FREQ_GOV_POWERSAVE=y
CONFIG_CPU_FREQ_GOV_USERSPACE=y
CONFIG_CPU_FREQ_GOV_ONDEMAND=y
CONFIG_CPU_FREQ_GOV_CONSERVATIVE=y
CONFIG_CPUFREQ_DT=y
CONFIG_CPU_IDLE=y
CONFIG_VFP=y
CONFIG_NEON=y
CONFIG_BINFMT_MISC=y
CONFIG_HIBERNATION=y
CONFIG_PM_RUNTIME=y
CONFIG_PM_DEBUG=y
CONFIG_PM_ADVANCED_DEBUG=y
CONFIG_APM_EMULATION=y
CONFIG_NET=y
CONFIG_PACKET=y
CONFIG_PACKET_DIAG=y
CONFIG_UNIX=y
CONFIG_UNIX_DIAG=y
CONFIG_INET=y
CONFIG_IPV6=y
CONFIG_NETWORK_PHY_TIMESTAMPING=y
CONFIG_VLAN_8021Q=y
CONFIG_NET_PKTGEN=y
CONFIG_CAN=y
CONFIG_CAN_VIRTIO=y
CONFIG_CFG80211=y
CONFIG_CFG80211_WEXT=y
CONFIG_MAC80211=y
CONFIG_RFKILL=y
CONFIG_RFKILL_GPIO=y
CONFIG_UEVENT_HELPER_PATH="/sbin/hotplug"
CONFIG_DEVTMPFS=y
CONFIG_DEVTMPFS_MOUNT=y
CONFIG_DMA_CMA=y
CONFIG_MTD=m
CONFIG_MTD_M25P80=m
CONFIG_MTD_ATLAS7_QSPI=m
CONFIG_MTD_SPI_NOR=m
CONFIG_BLK_DEV_LOOP=m
CONFIG_CSR_RFKILL=y
CONFIG_SCSI=y
CONFIG_BLK_DEV_SD=y
CONFIG_CHR_DEV_SG=y
CONFIG_NETDEVICES=y
# CONFIG_NET_VENDOR_BROADCOM is not set
# CONFIG_NET_VENDOR_CIRRUS is not set
# CONFIG_NET_VENDOR_FARADAY is not set
# CONFIG_NET_VENDOR_INTEL is not set
# CONFIG_NET_VENDOR_MARVELL is not set
# CONFIG_NET_VENDOR_MICREL is not set
# CONFIG_NET_VENDOR_MICROCHIP is not set
# CONFIG_NET_VENDOR_NATSEMI is not set
# CONFIG_NET_VENDOR_SEEQ is not set
# CONFIG_NET_VENDOR_SMSC is not set
# CONFIG_NET_VENDOR_STMICRO is not set
# CONFIG_NET_VENDOR_WIZNET is not set
CONFIG_USB_USBNET=y
# CONFIG_WLAN is not set
CONFIG_INPUT_MOUSEDEV=m
CONFIG_INPUT_EVDEV=y
CONFIG_INPUT_APMPOWER=y
CONFIG_KEYBOARD_ATKBD=m
CONFIG_KEYBOARD_ATLAS7ADC=y
# CONFIG_INPUT_MOUSE is not set
CONFIG_INPUT_TOUCHSCREEN=y
CONFIG_TOUCHSCREEN_FT5X06=y
CONFIG_TOUCHSCREEN_SIRFSOC=y
CONFIG_TOUCHSCREEN_SIRFSOC_CALIBRATE=y
CONFIG_INPUT_MISC=y
CONFIG_SERIO=m
CONFIG_LEGACY_PTY_COUNT=4
CONFIG_SERIAL_SIRFSOC=y
CONFIG_SERIAL_SIRFSOC_CONSOLE=y
CONFIG_HW_RANDOM=y
CONFIG_SIRF_SPI_SLAVE=m
CONFIG_I2C=y
CONFIG_I2C_CHARDEV=y
CONFIG_I2C_SIRF=y
CONFIG_I2C_MUX=y
CONFIG_I2C_MUX_PCA954x=y
CONFIG_SPI=y
CONFIG_SPI_SIRF=m
CONFIG_SPI_SPIDEV=m
CONFIG_PTP_1588_CLOCK=y
CONFIG_DEBUG_GPIO=y
CONFIG_GPIO_SYSFS=y
CONFIG_GPIO_GENERIC_PLATFORM=y
CONFIG_GPIO_SX150X=y
CONFIG_POWER_SUPPLY=y
CONFIG_BATTERY_SIRFSOC=m
CONFIG_SENSORS_SIRFSOC=y
CONFIG_THERMAL=y
CONFIG_CPU_THERMAL=y
CONFIG_WATCHDOG=y
CONFIG_ATLAS7_WATCHDOG=y
CONFIG_MFD_SIRFSOC_PWRC=y
CONFIG_REGULATOR=y
CONFIG_REGULATOR_FIXED_VOLTAGE=y
CONFIG_REGULATOR_ATLAS7_PMU=y
CONFIG_REGULATOR_GPIO=y
CONFIG_REGULATOR_PWM=y
CONFIG_MEDIA_SUPPORT=y
CONFIG_MEDIA_CAMERA_SUPPORT=y
CONFIG_MEDIA_RADIO_SUPPORT=y
CONFIG_V4L_PLATFORM_DRIVERS=y
# CONFIG_MEDIA_SUBDRV_AUTOSELECT is not set
CONFIG_VIDEO_IT68013=y
CONFIG_FB=y
CONFIG_BACKLIGHT_LCD_SUPPORT=y
CONFIG_BACKLIGHT_CLASS_DEVICE=y
CONFIG_BACKLIGHT_PWM=y
CONFIG_LOGO=y
# CONFIG_LOGO_LINUX_MONO is not set
# CONFIG_LOGO_LINUX_VGA16 is not set
# CONFIG_LOGO_LINUX_CLUT224 is not set
CONFIG_SIRFSOC_PULSEC=y
CONFIG_SOUND=y
CONFIG_SND=y
CONFIG_SND_DYNAMIC_MINORS=y
CONFIG_SND_USB_AUDIO=y
CONFIG_SND_SOC=y
CONFIG_SND_SOC_SIRF_KALIMBA_M3=y
CONFIG_SND_SOC_SIRF_KALIMBA_DEBUG=y
CONFIG_SND_SOC_BT_SCO=y
CONFIG_SND_SIMPLE_CARD=y
CONFIG_HID=m
CONFIG_USB_HID=m
CONFIG_USB=y
CONFIG_USB_ANNOUNCE_NEW_DEVICES=y
CONFIG_USB_OTG_FSM=y
CONFIG_USB_EHCI_HCD=y
CONFIG_USB_STORAGE=y
CONFIG_USB_CHIPIDEA=y
CONFIG_USB_CHIPIDEA_UDC=y
CONFIG_USB_CHIPIDEA_HOST=y
CONFIG_USB_CHIPIDEA_DEBUG=y
CONFIG_NOP_USB_XCEIV=y
CONFIG_USB_SIRF_PHY=y
CONFIG_USB_GADGET=y
CONFIG_USB_ETH=m
CONFIG_USB_G_NCM=m
CONFIG_USB_MASS_STORAGE=m
CONFIG_USB_SERIAL=y
CONFIG_USB_SERIAL_FTDI_SIO=y
CONFIG_MMC=y
CONFIG_MMC_SDHCI=y
CONFIG_MMC_SDHCI_PLTFM=y
CONFIG_MMC_SDHCI_SIRF=y
CONFIG_RTC_CLASS=y
CONFIG_RTC_DRV_SIRFSOC=y
CONFIG_DMADEVICES=y
CONFIG_DMADEVICES_DEBUG=y
CONFIG_DMADEVICES_VDEBUG=y
CONFIG_SIRF_DMA=y
CONFIG_ASYNC_TX_DMA=y
CONFIG_STAGING=y
CONFIG_ION=y
CONFIG_HWSPINLOCK_SIRF=y
# CONFIG_IOMMU_SUPPORT is not set
CONFIG_SIRF_REMOTEPROC=y
CONFIG_EXTCON=y
CONFIG_EXTCON_GPIO=y
CONFIG_PWM=y
CONFIG_PWM_SIRF=y
CONFIG_EXT4_FS=y
# CONFIG_EXT4_USE_FOR_EXT23 is not set
CONFIG_FANOTIFY=y
CONFIG_AUTOFS4_FS=y
CONFIG_FUSE_FS=y
CONFIG_MSDOS_FS=y
CONFIG_VFAT_FS=y
CONFIG_TMPFS=y
CONFIG_TMPFS_POSIX_ACL=y
CONFIG_OVERLAY_FS=y
# CONFIG_MISC_FILESYSTEMS is not set
CONFIG_NLS_CODEPAGE_437=y
CONFIG_NLS_ASCII=y
CONFIG_NLS_ISO8859_1=y
CONFIG_PRINTK_TIME=y
CONFIG_DEBUG_FS=y
CONFIG_DEBUG_SECTION_MISMATCH=y
# CONFIG_SCHED_DEBUG is not set
# CONFIG_DEBUG_PREEMPT is not set
CONFIG_DEBUG_RT_MUTEXES=y
CONFIG_DEBUG_SPINLOCK=y
CONFIG_DEBUG_MUTEXES=y
# CONFIG_DEBUG_BUGVERBOSE is not set
# CONFIG_CRYPTO_MANAGER_DISABLE_TESTS is not set
CONFIG_CRYPTO_TEST=m
CONFIG_CRYPTO_DES=m
CONFIG_CRYPTO_USER_API_HASH=m
CONFIG_CRYPTO_USER_API_SKCIPHER=m
CONFIG_CRC_CCITT=y
CONFIG_DEBUG_SET_MODULE_RONX=y
CONFIG_COMPAT_BRK=n
```
