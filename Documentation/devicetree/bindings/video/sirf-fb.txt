## drivers/bus/noc/Kconfig
```kconfig
if ARCH_SIRF

config ATLAS7_NOC
	bool "CSR A7DA NOC"
	default y
	help
	  Support CSR SiRFSoC A7DA Platform NOC bus, with security dram/reg
	  firewall and related configure for validation, with errlog shown
	  on data abort or interrupt handler when bus transaction failed,
	  with bandwidth probe functionality.

config ATLAS7_NOC_TRACING
	bool "NOC trace points"
	depends on ATLAS7_NOC
	default y
	help
	  Support NOC trace points for bandwidth consumption of interested
	  masters. by record trace data of bytes for certain period of
	  interval, can gather bandwidth consumption data for each period
	  thus, can provide upper layer to draw bw consumption graph.

config ATLAS7_NOC_FW
	bool "NOC firewall feature"
	depends on ATLAS7_NOC
	default n
	help
	  Support NOC firewall configure. support spram firewall locking and also
	  register firewall locking, customer could adopt this feature to block
	  non-secure state master to access secure spram range or secure register
	  range.

endif
```

## drivers/media/mjpeg/Kconfig
```kconfig
config MJPEG
	bool "MotionJPEG IP"
	default y
	---help---
	  This enable the support for the MotionJPEG on Atlas7 platform. The
	  MJPEG device driver could enocode yuv422 into jpeg files and can
          decode yuv422 and yuv420 jpeg into yuv422 files.
	  If you plan use the driver on atlas7, say Y here.
```

## drivers/media/mmc/csr/Kconfig
```kconfig
#
# CSR TuneX chip SDIO support
#
#
config CSR_TUNEX
	tristate "CSR Tunex SDIO Radio Char driver"
	depends on MMC
	default y
	help
	  Choose Y here if you have the CSR tuneX

	  To complier this drver as a module, choose M here:
	  the module will be called radio-csr
	  the driver only transfer data and access register
 	  between the chip and SDR service
```

## drivers/media/platform/sirfsoc/Kconfig
```kconfig
menuconfig VIDEO_SIRFSOC
	tristate "SiRF Soc Video Subsystem"
        depends on VIDEO_DEV && ARCH_SIRF
	default y
	help
		SiRF Soc V4L2 Video Subsystem support

if VIDEO_SIRFSOC

config VIDEO_SIRFSOC_CVD
    tristate "SIRFSOC Composite Video Decoder driver"
	depends on ARCH_SIRF
	default y
	help
	  This is a sub device driver for the SiRFSOC Video Input Port 0.
	  CVBS Decoder (CVD) IP solution contains a single-channel
	  dual-input CVBS Decoder.
	  Only one of the two video inputs can be processed at any time.

config VIDEO_SIRFSOC_VIP
    tristate "SIRFSOC Video Input Port driver"
	depends on VIDEO_DEV && ARCH_SIRF && VIDEO_V4L2 && HAS_DMA && I2C
	select VIDEOBUF_GEN
	select VIDEOBUF_DMA_CONTIG
	select VIDEOBUF2_CORE
	select VIDEOBUF2_DMA_CONTIG
	default y
	help
	  This is a v4l2 driver for the SiRFSOC Video Input Port

menuconfig VIDEO_SIRFSOC_REARVIEW
    tristate "SIRFSOC Rearview driver"
    depends on ARCH_SIRF && SIRF_VDSS && VIDEO_SIRFSOC_CVD && VIDEO_SIRFSOC_VIP && INPUT
    select KEYBOARD_GPIO
	default y
    help
	  SiRF Soc Hardware Rearview solution driver, when it is trigger,
	  CVBS camera -> CVD -> VIP0 -> DRAM -> VPP0 -> LCD0 path will run and
	  controlled by hardware automatically.
	  Please note, its priority is higher than DVD playback(using CVD/VIP0 HW)
	  and video playback(using VPP0 HW) cases.

menuconfig REARVIEW_AUXILIARY
	bool "Rearview auxiliary line support"
	depends on VIDEO_SIRFSOC_REARVIEW
	default n
	help
	  Say Y here if you want kernel to draw distance auxiliary line on the top
	  of rearview picture.

config AUXILIARY_TRANSPARENT_VALUE
	int "Percent value of rearview auxiliary line transparent"
	range 0 100
	default 50
	depends on REARVIEW_AUXILIARY
	help
	  0 means no transparent totally, we can't see the background of lines.
	  50 means 50 percent transparent, we can see both background and lines.
	  100 means 100 percent transparent, we can't see the auxiliary lines.

choice
	prompt "Rearview De-Interlace Methods"
	default MEAVE
	help
	  This option indicates the HW de-interlace method for interlaced
	  video sequence.

config FIELD_DROP
	bool "Intra-field spatial interpolation"
	help
	  Intra-field spatial interpolation(Field drop) is the process of
	  completely discarding one of the fields in an interlaced video
	  data. Either all the odd or all the even fields are discarded.
	  Using the fields that remain, interpolation is performed between
	  the lines to generate an entire noninterlaced frame.

config 3TAP_MEDIAN
	bool "3-tap Median Interpolation method"
	help
	  3-tap Median Interpolation(inter-field spatial interpolation) is
	  the process of reserving one of the fields in an interlaced video
	  data while interpolate the other field data with 3-tap median algorithm.
	  Either all the odd fields are reserved and the even fields are
	  interpolated or the even fields are reserved and all the odd fields
	  are interpolated. The interpolated value is generated by choose median
	  value from the vertically adjacent three pixel values.

config MEAVE
	bool "Weave De-Interlace method"
	help
	  Weave(merging) is the process of combining the odd
	  and even fields of an interlaced video image to generate
	  the entire non-interlaced frame.
	  You can select this method to enable de-interlacer.

config VERTICAL_MEDIAN
	bool "Vertical Median Ranking Interpolation method"
	help
	  Vertical Median Ranking is also the inter-field interpolation algorithm,
	  the interpolated value is adaptive according to the median ranking
	  result. Assume X is the pixel to be interpolated.
	  You can select this method to enable de-interlacer.

endchoice

menuconfig VIDEO_SIRFSOC_VOUT
    tristate "SIRFSOC Video Output driver"
	depends on VIDEO_DEV && ARCH_SIRF && SIRF_VDSS && VIDEO_V4L2 && HAS_DMA && I2C
	select VIDEOBUF_GEN
	select VIDEOBUF_DMA_CONTIG
	select VIDEOBUF2_CORE
	select VIDEOBUF2_DMA_CONTIG
	default y
	help
	  This is a v4l2 driver for the SiRFSOC Video Output

endif
```

## drivers/media/radio/atlas7sdr/Kconfig
```kconfig
config SDR_SIRFSOC
	tristate "SiRF SOC SDR Accelerator module"
	depends on ARCH_ATLAS7
	default y
	select REGMAP_MMIO
	---help---
	  Support for SIRFSOC SDR Accelerator module. The SDR acceleraotr only
	  exist on the Atlas7DA.
```

## drivers/misc/hs_i2s/Kconfig
```kconfig
config ATLAS7_HSI2S
	tristate "atlas7 high speed i2s module"
	depends on ARCH_ATLAS7
	default y
	select REGMAP_MMIO
	---help---
	  Support for atlas7 high speed i2s(HS-I2S) module. The HS-I2S only
	  exist on the Atlas7DA, HS-I2S support up to 75M Hz clock and it
	  support 2 RX lines. There are 2 HS-I2S controller on Atlas7.
	  Say Y if you connect a device to HS-I2S port.
```

## drivers/misc/ts/Kconfig
```kconfig
config ATLAS7_USP_VIP_TS
	tristate "atlas7 usp and vip ts module"
	depends on ARCH_ATLAS7
	default y
	select REGMAP_MMIO
	---help---
	  Support for atlas7 ts module. it can support 2 kinds of TS port,
	  USP TS port and VIP TS port. you need include the corresponding
	  dtsi files in the dts file.
	  Say Y if you connect a device to TS port.

config ATLAS7_TS_DEBUG
	bool "atlas7 usp ts module debug"
	depends on ATLAS7_USP_VIP_TS
	default n
	---help---
	  output the message in the isr for the TS driver.
```

## drivers/soc/sirf/Kconfig
```kconfig
#
# CSR Soc drivers
#

config CSRVISOR_WRAPPER
	tristate "CSRVisor fastcall wrapper"
	depends on ARCH_ATLAS7
	default y
	help
	  SiRFSoc CSRVisor call agent based on fastcall method
```

## drivers/video/fbdev/sirfsoc/Kconfig
```kconfig
if ARCH_SIRF

source "drivers/video/fbdev/sirfsoc/vdss/Kconfig"
source "drivers/video/fbdev/sirfsoc/vdsscomp/Kconfig"
source "drivers/video/fbdev/sirfsoc/fb/Kconfig"
source "drivers/video/fbdev/sirfsoc/panels/Kconfig"
source "drivers/video/fbdev/sirfsoc/g2d/Kconfig"

endif
```

## drivers/video/fbdev/sirfsoc/fb/Kconfig
```kconfig
menuconfig FB_SIRF
        tristate "SiRF Soc frame buffer support"
	default y
        depends on FB && SIRF_VDSS
        select FB_CFB_FILLRECT
        select FB_CFB_COPYAREA
        select FB_CFB_IMAGEBLIT
        help
	  This is the frame buffer device driver for SiRF Soc series boards.
	  Say Y if you have such SiRF Soc board like SiRFAtlasVI/SiRFPrimaII
	  /SiRFAltas7DA.

	  To compile this driver as a module, choose M here: the module will
	  be named as sirfsocfb.

config FB_SIRF_DEBUG_SUPPORT
        bool "Debug support for SiRF Soc FB"
	default y
	depends on FB_SIRF
	help
	  Say Y here if you want the frame buffer driver to output all sorts
	  of debugging information to provide to the maintainer when something
	  goes wrong. You have to enable the actual printing with 'debug'
	  module parameter.

config FB_SIRF_NUM_FBS
	int "Number of framebuffers"
	range 1 10
	default 3
	depends on FB_SIRF
	help
	  Select the number of framebuffers created.
```

## drivers/video/fbdev/sirfsoc/g2d/Kconfig
```kconfig
#
# 2D Graphics Accelerator On Sirf Soc.
#
# Copyright (c) 2015-2016, The Linux Foundation. All rights reserved.
#
# This program is free software; you can redistribute it and/or modify
# it under the terms of the GNU General Public License version 2 and
# only version 2 as published by the Free Software Foundation.
#
# This program is distributed in the hope that it will be useful,
# but WITHOUT ANY WARRANTY; without even the implied warranty of
# MERCHANTABILITY or FITNESS FOR A PARTICULAR PURPOSE.  See the
# GNU General Public License for more details.
#

menuconfig SIRF_G2D
	tristate "SirfSOc 2D Graphics Accelerator"
	depends on ARCH_ATLAS7 && SIRF_VDSS
	default y
	help
	 This module could accelerate 2D bitblt operation. It implements
	 bitblt in RGB mode with G2D hardware. It also provides the
	 interface to VPP in VDSS for YUV to RGB conversion. To unify blt
	 api, the two functions are integrated together.

if SIRF_G2D

config SIRF_G2D_DEBUG_LOG
	bool "Enable debug log in G2D"
	default n
	help
	 This enabled extra debug checks and messages in the G2D driver.
	 for example, operations and parameters with them.
	 It only for internal debuging.
	 If you are not sure of it, let it remain NO.

endif #SIRF_G2D
```

## drivers/video/fbdev/sirfsoc/panels/Kconfig
```kconfig
menu "SiRF Soc Panel Drivers"
        depends on SIRF_VDSS

config DISPLAY_PANEL_RGB
	tristate "Generic RGB panel"
	default y
	depends on I2C
	select VIDEOMODE_HELPERS
	help
	  Driver for generic RGB panels.

config DISPLAY_PANEL_LVDS
	tristate "Generic LVDS panel"
	default y
	select VIDEOMODE_HELPERS
	help
	  Driver for generic LVDS panels.

config DISPLAY_HDMI
	tristate "Generic HDMI panel"
	default y
	select VIDEOMODE_HELPERS
	help
	  Driver for generic HDMI output drived by IT6610 HDMI transmitter.

endmenu
```

## drivers/video/fbdev/sirfsoc/vdss/Kconfig
```kconfig
menuconfig SIRF_VDSS
        tristate "SIRFSOC Video Display Subsystem support"
	default y
	select VIDEOMODE_HELPERS
        help
	  SiRF Soc Video Display Subsystem support. The VDSS exposes a series
	  of APIs to the user interface drivers like V4L2 and Frame buffer
	  device. It also exposes the functions for registering/de-registering
	  of the various display devices like LCD and LVDS to the VDSS.

if SIRF_VDSS

config SIRF_VDSS_DEBUG
	bool "Debug support"
	default n
	help
	  This enables printing of debug messages.

endif
```

## drivers/video/fbdev/sirfsoc/vdsscomp/Kconfig
```kconfig
menuconfig VDSSCOMP
	tristate "SIRFSOC VDSS Composition support"
	depends on SIRF_VDSS
	default y

	help
	  Frame composition driver using SIRFSOC VDSS. Allows using
	  all VDSS resources in a unified configuration. Should not
	  be used together with other VDSS client devices, such as
	  V4L2 output or SIRFSOCFB.

config VDSSCOMP_DEBUG
	bool "Debug support for VDSSComp"
	depends on VDSSCOMP
	default n

	help
	  Support for debug output. you can dump detailed layer
	  setting information for some vdsscomp configuration.
	  The default is n, please choose y to to enable such
	  support.
```

## sound/soc/sirf/Kconfig
```kconfig
config SND_SOC_SIRF
	tristate "SoC Audio for the SiRF SoC chips"
	depends on ARCH_SIRF || COMPILE_TEST
	select SND_SOC_GENERIC_DMAENGINE_PCM

config SND_SOC_SIRF_ATLAS7_IACC
	tristate "SoC Audio for SiRF atlas7 internal audio codec interface"
	depends on SND_SOC_SIRF
	select REGMAP_MMIO
	help
	  This driver support the internal audio codec interface of Atlas7 SoC.
	  As oupput feature, support 4 channels, maximum 192Khz sample
	  rate, 24bits sample precision.
	  As input feature, support 2 channels, maximum 96Khz sample
	  rate, 24bits sample precision.

config SND_SOC_SIRF_AUDIO_PORT
	select REGMAP_MMIO
	tristate

config SND_SOC_SIRF_AUDIO
	tristate "SoC Audio support for SiRF internal audio codec"
	depends on SND_SOC_SIRF
	select SND_SOC_SIRF_AUDIO_CODEC
	select SND_SOC_SIRF_AUDIO_PORT

config SND_SOC_SIRF_I2S
	tristate "SoC Audio support for SiRF I2S interface"
	depends on SND_SOC_SIRF
	select REGMAP_MMIO
	tristate

config SND_SOC_SIRF_ATLAS7_CS42XX8
	tristate "SoC Audio support for CSRatlas7 board using CS42XX8 codec"
	depends on SND_SOC_SIRF && I2C
	select SND_SOC_CS42XX8_I2C
	help
	  Say Y or M here if you want to add support for SoC audio on CSRatlas7
	  boards using external codec.
	  - CPU DAI: I2S
	  - Codec: CS42XX8

config SND_SOC_SIRF_USP
	tristate "SoC Audio (I2S protocol) for SiRF SoC USP interface"
	depends on SND_SOC_SIRF
	select REGMAP_MMIO
	tristate

# SiRF kalimba DSP support
source "sound/soc/sirf/kalimba/Kconfig"
source "sound/soc/sirf/kalimba-m3/Kconfig"
```

## sound/soc/sirf/kalimba-m3/kcm/Kconfig
```kconfig
config SND_SOC_SIRF_KALIMBA_KCM_USER
	bool "KCM user database"
	depends on SND_SOC_SIRF_KALIMBA_M3_KCM
	help
	  Kalimba configuration manager user database is a user defined
	  configure set. User can define their own operators, links and
	  chains. If not selected, default database will be actived. The
	  default case is designed for Desay.
```

## sound/soc/sirf/kalimba/Kconfig
```kconfig
config SND_SOC_SIRF_KALIMBA
	tristate "Kalimba driver"
	select REGMAP_MMIO
	help
	  Kalimba is audio DSP process which support mix, sample rate
	  convert and echo cancellation etc features. Kalimba gets the
	  audio data from the frontend device and puts the audio data
	  to backend device.

config SND_SOC_SIRF_KALIMBA_DEBUG
	tristate "Kalimba driver debug"
	depends on SND_SOC_SIRF_KALIMBA
	help
	  Kalimba debug interface which helps to develop the code of kalimba,
	  it alloc, free and fill memory by test tool use.
	  It also initialize hardware audio device, such as I2S, codec and dma.
	  It also prepare the interface to user space test tools.

config SND_SOC_SIRF_KALIMBA_KCM
	bool "Kalimba configuration manager driver"
	default y
	depends on SND_SOC_SIRF_KALIMBA
	help
	  Kalimba configuration manager driver is to introduce a flexible
	  way to define, control, and deploy audio subsystem based on
	  Kalimba DSP. It's to replace the hard coded audio pipeline manager,
	  and to support various audio pipelines with one common code set.

source "sound/soc/sirf/kalimba/kcm/Kconfig"
```
